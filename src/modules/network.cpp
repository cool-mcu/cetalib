/*
 * Copyright (C) 2026 dBm Signal Dynamics Inc.
 *
 * File:            network.cpp
 * Project:         
 * Date:            June 07, 2026
 * Framework:       Arduino w. Arduino-Pico Core Pkge by Earl Philhower
 *                  (https://github.com/earlephilhower/arduino-pico)
 * 
 * cetalib "network" driver interface functions
 *
 * Hardware Configurations Supported:
 * 
 * CETA IoT Robot (Schematic #14-00069A/B), based on RPI-Pico-WH
 * (Select "Board = Raspberry Pi Pico W")
 * 
 * Sparkfun XRP Robot Platform (#KIT-27644), based on the RPI RP2350B MCU
 * (Select "Board = SparkFun XRP Controller")
 *
 * Sparkfun XRP (Beta) Robot Platform (#KIT-22230), based on the RPI Pico W
 * (Select "Board = SparkFun XRP Controller (Beta)")
 */

/** Include Files *************************************************************/
#include <Arduino.h>              
#include <WiFi.h>                   
#include <WebServer.h>
#include <DNSServer.h>
#include <LittleFS.h>
#include <string.h>
#include "network.h"

// Sanity check: Ensure a filesystem partition has been allocated in the IDE Tools menu
#if defined(FS_START) && defined(FS_END)
    #if (FS_START == FS_END)
        #if defined(ARDUINO_RASPBERRY_PI_PICO_W) || defined(ARDUINO_SPARKFUN_XRP_CONTROLLER_BETA)
          #error "CRITICAL: No Filesystem space allocated! Please go to Tools -> Flash Size and select the following FS partition option: '2MB (Sketch: 1984KB, FS: 64KB)'."
        #elif defined(ARDUINO_SPARKFUN_XRP_CONTROLLER)
          #error "CRITICAL: No Filesystem space allocated! Please go to Tools -> Flash Size and select the following FS partition option: '16MB (Sketch: 16320KB, FS: 64KB)'."
        #else
          #error "Unsupported board selection"
        #endif
    #endif
#else
    // Fallback for unexpected environments where macros aren't defined
    #warning "FS_START or FS_END macros are missing. Ensure you are using the Earl Philhower arduino-pico core."
#endif

/*** Symbolic Constants used in this module ***********************************/
#define SERIAL_PORT Serial  // Default to Serial
#if defined(NO_USB)
    #undef SERIAL_PORT
    #define SERIAL_PORT Serial1     // Use Serial1 if USB is disabled
#endif

// Symbolic constants for Network Manager to manage WiFi connection
#define NM_LED_PATTERN_INTERVAL 100   // interval for let pattern update
#define NM_CHECK_INTERVAL 1000        // 1000ms monitor window
#define NM_RECONNECT_TIMEOUT 15000    // 15 seconds max to lock a link

/*** Global Variable Declarations *********************************************/

// Web and DNS Server Instances
WebServer server(80);
DNSServer dnsServer;

IPAddress apIPAddr(192, 168, 4, 1);                 // WiFi network AP IP address
IPAddress apGateway(192, 168, 4, 1);              // WiFi network apGateway IP Address
IPAddress apSubnet(255, 255, 255, 0);             // WiFi network apSubnet Mask

// Local IP Address
static char localIPAddress[32];                 // used by getIPAddr() to pass IP address to application

// Configuration Parameters
char ap_ssid[64];                               // AP SSID
char ap_pass[64];                               // AP PASSPHRASE
char sta_hostname[64];                          // STA HOSTNAME
int ap_channel;                                 // WiFi network radio channel to use (1, 6 or 11)
byte macAddress[6];                                // WiFi radio IEEE MAC address used to generate unique SSID and passphrase
                                                // SSID: "XRPBeta_abcd", where "abcd" are the last 2 mac address hex bytes
                                                // Pass: "XRPBeta_abcd"
const char* config_file = "/wifi_cred.txt";
const byte DNS_PORT = 53;

// Hardware reset button variables
const unsigned long DEBOUNCE_DELAY = 50; 
const unsigned long HOLD_TIME = 3000;    // Hold for 3 seconds to wipe config

// Cool-MCU.com Logo, converted to a Base64 string
// Used https://base64-image.de to convert "logo-White.png" file
const String logo_base64 = "iVBORw0KGgoAAAANSUhEUgAABIgAAAEsCAYAAAComYicAAAACXBIWXMAABcSAAAXEgFnn9JSAAAAB3RJTUUH5AcYADQA3aajowAAAAd0RVh0QXV0aG9yAKmuzEgAAAAMdEVYdERlc2NyaXB0aW9uABMJISMAAAAKdEVYdENvcHlyaWdodACsD8w6AAAADnRFWHRDcmVhdGlvbiB0aW1lADX3DwkAAAAJdEVYdFNvZnR3YXJlAF1w/zoAAAALdEVYdERpc2NsYWltZXIAt8C0jwAAAAh0RVh0V2FybmluZwDAG+aHAAAAB3RFWHRTb3VyY2UA9f+D6wAAAAh0RVh0Q29tbWVudAD2zJa/AAAABnRFWHRUaXRsZQCo7tInAAAgAElEQVR4nOzdf1SUZf4//utSpmbcpritWRmDmjFQKDVARVCjQdYwWUEFhIIImT3ertM6vtMT99b726/vWmMfbXc8Xy063wHkK2akKJQ/0Dc/whTElSFzhYVy6I3vwDAHw2Tei3p//wjaCQfm1z0w5PNxzn1O3D+u6xpl5jjPrut1UZ7nCQAMj1I6bvbs2dvvueeeS1VVVa+r1eqwmzdv+o4fP95iMBjqrG7FGwoAAAAAAADGHIqACGB4Wq12cllZWZHJZFJJpdIOjUbzSG5u7nmz2awYuEcsFneHhIQcCAoKKpPL5dV6vb6bICwCAAAAAACAMQIBEcAwkpOTn/3000+3WywW3/5TfGxs7KsVFRX/93DP+fn5NT722GPFCoWi2mqGEd5sAAAAAAAA4JUQEAEMITExMbu0tNQw+Lyvr+9/d3d3P+RoO1KptDM4OPjAvffe+99z5swp0Ol0nf2X8OYDAAAAAAAAr4CACGAQSildsmTJHw8ePLjdE+0HBATUicXi7ujo6DcxuwgAAAAAAAC8AQIiACssy05oaGjYevr06TUj0Z9YLO6eMWPGnnvvvfe/FQrFEYPB0Nh/CW9MAAAAAAAAGDEIiAD6sSw78ejRo/tMJpNqtMYgk8mag4ODD0ycOLGltLS0YNBlvFkBAAAAAADAIxAQARBCNBrNlN27d1dY70zmDRiGafP19W1TKBSfyWSyL4o//vgAIYQQvHEBAAAAAABAQAiI4I7HsuzE4uLiM94WDtkysCRt4sSJLXK5vPG+++5r1Ov13f2X8WYGAAAAAAAAlyAggjsay7ITS0tLKzo7O0NHeyyukkqlnY899tie4ODgsoKCgmqrS3hzAwAAAAAAgEMQEMEdiVJKs7Ozo8rKygxdXV3Boz0eIclksuZHHnnkyP33398yY8aMAzqdrtPqMt7wAAAAAAAAcBsERHDHoZSOW7Bgwabjx49zoz2WkSAWi7vlcnnjpEmTGn/zm998FxwcfGD79u3N/ZfxAQAAAAAAAAAIiODOwrLshM8++6youbl52WiPZbQFBwcfmDZtWhnDMG1YmgYAAAAAAHBnQ0A0xmg0mpDV75c2P37zolf/xVFKqbPP8B7+ZaSUjps2bdo+hEO2yWSy5uDg4ANTp04tNhgMjVaXvPp3DQAAAAAAANyHgGgMUavV8woLCyvEYnH3vHnz3jl69OjfPB2q2PGLEIjjOL/Ozs7gjo6O0H/961/3EULItWvXJl2+fHnYGj8PPPBA8z333HPprrvuuhoYGHikf/mToK+LUkoXLFjw1p2yrEwIMpmsefr06R89/PDDn/n5+TVb1TLChwYAAAAAAMCvDAKiMcLWVuwRERHv1dfXr3Wzaadn+hBCSFZWluqbb7558vLly9O+/PLLNDfH8AsikcgSHR395vTp09/ftm1bt7shGKV0nEqlerWqquo1ocZ4J5LJZM0KhaJaqVQelclkzVZ1jAhBaAQAAAAAADCmISAaAyilNDQ0NM9oNGYNusTHxsa+UlFR8bajTVn/kJycnPb9999Ps/fQ5cuXp127ds3v2rVrfiO945dSqax+8skn39y5c2e1K0ERpXTc7Nmzt58+fXqNJ8Z3J7Mufn3ffff9t1wub7SqZYQPFgAAAAAAgDEEAdEYkJiYmF1aWmoY4jKfkZERv2vXrsM2rlFCfprtc+3aNb9Lly7NvHjxYmR3d7fCeibSWBATE/NGdXX1G86ERCzLTqisrNzX2tq6WMixjBs37ub999/fcuPGDbGdP0eXZmc5wdU3r8fGJZVKO0NDQwvuuuuuHwbtljYAHzgAAAAAAABeCAGRl9NoNFM++OCDf/T19YmHukculxs7OjrCrc9xHCc5ceLEq42NjVk9PT1+nh+p54WFheXHxcVpdDpdr717PRUOSSSSK2lpaUn5+fnVQ93DcZxvS0vLMmdCuM7Ozpl+fn5nnRnLrFmzCrZs2dLmzDMrVqzIunz58tT29vZIi8Xi29HREWrjNsEDJKVSWa1QKD578MEHT913331tNoIjQhAeAQAAAAAAjBoERF6M4zhJUVFRZXt7e6SdW3mtVvuoXq9v1mq1zLlz59Y0NDSs9uAsoZ9/acRicXdYWFhBW1ubyips8NgMFblcbnz++efnDxcSUUrHBQYGHvREOJSZmRmbm5vbaP/usWXjxo2K77//XnH16lWF2WxWNDc3J9gIjwT9ex1YokYIIf7+/nXDzDqyhg8sAAAAAAAAD0BA5KWc3XVrzpw57z/88MPHy8vLt3poxhAvl8sbg4ODy2QyWTPDMM22ghKWZSONRmOmyWRS9dcrEjwsCgsLyzcajdm2rlFK6ezZs3cIXXNIJBJdf+aZZ5IKCwuPCNmut+M4zvfSpUuhFy9ejLxx44b44sWLEZ2dnaFWv2MeCwOtAyRCCFEoFJ/dddddV63P+fn51el0OouNx/HBBgAAAAAA4AQERF4qMzNzYWFhYcUoD4NnGKZtxowZe+bNm7fNaptzh6jV6rCamppN/TN5BAsSGIa5wLLsLJ1O1219nlJKVSrVa0LvViaVSr9NTk5OH25Z2Z1m8+bN4jNnzizr6uoKvnjxYsTAkrX+y56uvWTTwC5r99xzz6UJEyZckslkzX5+fs02fm/xoQcAAAAAADAIAiIvpNVqJ+fl5Z0ZxdpBvFQq7YyMjNx27NgxnbuNxcXF/Ud5eflWIkBwIJFIrqxevXq+Xq//xTIkT4VDSqWyMjU1NWlwGAW34zjOz2g0pn333Xczm5qalvUHRqMSFg3GMEzbtGnTDkgkkqsymewLuVxerdfrrf9O8UEIAAAAAAB3NAREXoZSSgMDAw8JXT/HUVKp9Nv4+HjNnj17DgjZbkZGxtMfffTRvr6+PokbzdzKzMyMH7zMi1I6TqVSvSp0ODR16tRDarU6KScnx9YSJhjGwNK05ubmhHPnzqWNxJI0Z/n5+TVKJJLuSZMmNQYHB5cVFBRU91/ChyIAAAAAANxxEBB5mUWLFr147NixraPQNR8dHf12TU3NK57qwM2QiF+0aNHLg2c0UUrHzZ07d2tdXd16gYZJCCH8zJkzP0xPT1cjHBLGwOyilpaWhI6OjlBvml00QCQSWWbNmvX+rFmzPrAqlI0PSAAAAAAAuCMgIPIiWq1WuWPHjvPDbWnvAXxERMT7YWFhhbm5uXWe7kyj0YTs3r37oNlsVjrz3MyZM3efPXs23focy7ITjh49etBkMqmEGp9IJLq+dOlSTUlJSYFQbcIvcRzne+bMmTXnzp1bORI737lCKpV2Pvjgg3UBAQGnhFhmCQAAAAAA4O18RnsA8G/Z/8++tpLJfkZCSNRI9DewM1d9ff2I7cy1ffv2Jh8fn1iGYSocDYkCAgJOvvDCC2rrc5TScdOnTzcIGQ5JJJIr2dnZv8pt7L1Jfz0nHSFEt3nzZnFlZeWakydPvtS/DM0rgqL+sSyLiooyjfZYAAAAAAAARsK40R4A/NvjNy/yCQkJapFI1OvpvqRS6bdr166dNRrbtuv1elNmZmYswzB2v3wzDHMhPT39F3WAKKXjFixYsOnLL79ME2pMEonkSmZmJsKhEZaTk2MpLy//W09Pz+RFixa9PBK/+44SiUS9Tz755DujPQ4AAAAAAICRgCVmXqh/1693PdW+XC5vSEhI0IzEkrLhaLVaZWFh4ZAziUQi0fXs7Oz51qENy7ITTp48aRAyHGIY5sLKlSuTEA6NPo7j/D777LOX/v73v69xs6C526Kiov5aW1v74miOAQAAAAAAYKQgIPJClFIaHBy8r6mpabnATfNyudy4fv36+d5SfLm/7tI/bIQBfFpa2grr3dQopXT69Om7hQyHAgICTqanpyfpdLpOodoE9w0ERbW1tevJKCw7E4lEvRs2bJiC3wsAAAAAALhTICDyUlqtlikuLq7o6OgIE6I9qVTaERkZuW3WrFnv99eA8Rq2ZkzFxMS8UVVV9frAzx7Yyt7ju7aB+zQaTcjRo0e3tra2LiYjGBRh9hAAAAAAANxpEBB5MbVaHVZYWHjS3V3N+mfJxHtbMDRg8IypkJCQkqampiSr6+Nmz569/fTp02uE6E8ikVxJSUlJH436S+AajUYTcujQoe39Rck9GhRh9hAAAAAAANyJUKTaixkMBmN0dPSb7rQREBBwMjU1Nd1bwyFCCOF5nn/qqafUMpmsSS6XN2RlZf28nT2ldNy0adP2CRUOMQxzITMzMxbh0Niyffv2JpPJtHDlypVJhBCPptqzZ89+H+EQAAAAAADcaTCDyMtRSqlCoagwmUwxzjwnEokskZGRf/v973//hrfUG7Jn1apVqvvvv79ty5YtbYT8e7ey48ePc0K0zzDMBbVaHTvQPoxNaWlpy06dOrXOE7OJMHsIAAAAAADuVAiIxgBX6hFNmDDh8rp16x7S6XTDbRtOCSFErVaH3rx503fwxd/85jed27dvb+7/cUR/URAOgT1xcXHrGxoaVnd1dQUTgYIi1B4CAAAAAIA7FQKiMcKVkCgoKOhwUlJSknVIRCml69atUzQ3Ny/77rvvZnZ0dIR2dnaGDtUGwzBtgYGBR6ZNm1a2q6joCBmBXxiWZSd89tlnRc3NzcsEaI6fOXPmh0uWLNF48zI7cN2iRYu448ePv2SxWHyJm0HRb3/723MqlerV4o8/PjASv+sAAAAAAADeAgHRGKLVapmampqtRqNxlaPP9IdE6s2bN3euW7fOt6Gh4SVXZ+UwDGNatGjRho8//vgA76FfHEopnT179g6Bag7dWrp0qeaTTz55X4C2wMslJyc/U15evrWnp0fublt+fn6N0dHRbyIoAgAAAACAOwUCojHmi/H+9PeT6Yn29vYoZ55TKpXVHR0dof2zLNwSFhaWHxcXp7GzfM0lixYtevHYsWNbBWjq1ooVK9QlJSUFArQFYwTHcb6nTp1a//nnn7/U19cncbc9Pz+/RpVK9caePXsODJz7Yrz/L2YpPX7zIj5EAQAAAABgzENANAa5stxMaEqlsiohISFJr9ebhWozMzNz4Ycffniwr69P7E47Uqn02+Tk5PT8/PxqgYYGY4xWq1VWVVVtOnv27DPuthUSErK/qakpSa1WR16+fDn4hx9+eLitre3Jy5cvB8+ePTu3qqrqdQGGDAAAAAAAMKoQEI1RGo0mpLCwsEKI5TSuYhjGlJmZGavX603utqVWq8OLiooq3J3hpFQqK1NTU5NQbwgIpfS+e+/95urVqwHuNMMwTJvZbFbYuhYTE/MGAiIAAAAAAPg18BntAYBrtm/f3iSVSmeFhYVtOnfuXFr/rJvhCvQ6kwQ6VOjXbDYrxWLxmf/5n//R7N2790Mn2v8FocKhqVOnHlqzZk1STk6OxZ124NdhZUrKsqvFxW6FQ4QQMlQ4BAAAAAAA8GuCGUS/EmlpacvOnz+/sqenx8/W9cDAwKP+/v51hBAyadKkxsEzbLRabfAPP/zg9+OPP/qdPn16tclkinGiez4xMVFdWlqa7+y4NRrNlMLCwhNDjdvR/mfOnPlhenq6GuEQEEIIoZT6TZrUMNwOfULADCIAAAAAAPi1QEAEt6GUUpVK9VpVVdVrTjzGr1y5Mqm4uHi/ow+wLDuhtLT0hDtf4kUi0fWlS5dqUIwarCUnJz+7d+/eIk/3g4AIAAAAAAB+LcaN9gDA+/A8z1dXV7/xxBNP6Jx4jB4+fHi7Wq12aHc1Sum4zz77rMidcEgqlX6bnZ09H+EQWGNZdmJ5ebkQO+EBAAAAAADcMRAQgU08z/Pz589/08/Pr9HRZ3p6euQGg+FERkbG08PdRykdFxoaamhubl7m6vCmTp16SKPRzMrNzXV4fPDrRyml9fX1W91csggAAAAAAHDHQUAEQ9LpdL3R0dFvOvkYLS0tNWi1WqWtiyzLTggMDDxoNBqzXBmTSCTqXbRo0cstLS3xOp2u05U24NcrOzs71NXfLVfcvHnzrpHqCwAAAAAAwJOwixkMq/jjjw8Mt823LT09PXKxWHzm2rVrsQaDwThwnlI6btq0aUWtra2LXRmLRCK5kpGRkZSfn1/tyvPw60YppaGhoetGss+Ojg6PFsEGAAAAAAAYKZhBBHYFBgYecfYZi8XClJSU7OM4TkLIT1/eFyxYsMnVZWVyubxh9erV8xEOwVDWrVsnP3fuXNpI9nnjxg3xSPYHAAAAAADgKZhBBMPjef6xrKxiQsgaZx81m83KoKCgfYSQpKSkpOV79+7lXBlBRETEe+vXr9+ALexhKJRSOn369K19fX1uBTYMw5gUCkW10WhcJdTYAAAAAAAAxgJscw+OoFKp9FtXC/8++OCDf//uu++mO/vlHVvYg6PUavU8g8Fwws1meJZl5924ceN/i4qKKiwWC2PvAbFYbLZYLBPd7BcAAAAAAGDUYQYROCQ0NLSAEOLKDCDyP//zP7OdfQb1hsBRHMdJysrKDO62ExIScqCpqamOEEKuXr2qIYTstveMxWLxdbdfAAAAAAAAb4AaROAIfubMmYUj1ZlEIrmSmZkZi3AIHGE0Gtd0dXUFu9kMHxkZuW3gh7379u1hGKbNzTYBAAAAAADGDARE4BAfH59OkUjk8RpAUqn028zMzNjc3NxGT/cFYx/HcZKTJ0++5G47ERER7/8ikOR5PiIiYtvQT/xiDC4tvQQAAAAAAPAmCIgcRPuN9jicRYfhTDvbtm3rfuSRR5zezcwJfHh4eJ5Go3kM4RA4ymg0rnG1NtYAsVhsXrhw4ZuDz4eFhb0vl8uN9p5vaWlZ7E7/AAAAAAAA3gA1iBzQv0X7W11dXcEZGRkfFBUVHeG9p7r3bUGPWq2OvHnzpvj69eu+KpXq8aEejI2N/d+AgIA6Qgjx8/Or0+l0FkKIzdfF8zwfHx9/lBDi0jb1w5FIJFeefvrpDQ0NDQVCtw2/XkLNHgoLCyvQ6XSdg8/rdLre3t7eJIZhKs1ms2KIx+lXX331FCGkwN1xAAAAAAAAjCYERA5ISEhYVVpaOlCgednZs2c/5DhOrdPpekdoCDZDoIsXL0a2tLQkXLt2zc+6BovB4Fq93oCAgLonn3zyzV1FRT/NFBoUgs2YMaNAJpOtE6Dey8/kcnmDRqNJ2rJlS5tQbcKd4fTp0+vdnT0kEol6N2zY8M5Q1/V6vam5uXkbIeTdoe7BDCIAAAAAAPg1wDb3dmg0mikffPDBPwZv0R4UFHS4tbV1iZPN2V3WpdFogn/88cefv/Reu3bN7+uvv36qu7tbQQghFy9ejHR2u3hnSaXSzscee2yPSqV6R6fTdVhfi4uL+4/y8vIhvyw7gQ8JCdmfmJio1ul03QK0B3cSSqn0nnu+dTcgioqK+mttbe2Lw93DcZxk586dJzo6OsKGuIUnWK4LAAAAAABjHGYQDYNl2QmHDh0qshXItLa2Lk5LS1u2Z8+eA0M9TymlOTk5fp2dncHt7e2Rt27dupsQQi5fvjzt2rVrt32xHTwTaLT0f+leLxaLn29qatpQVlZWMLCkLjg4+AAZZjaFI0QiUa9KpXqzqalJJ8R44c6zMiVleU9xsVvhkEQiuaLVaoecPTRAp9P1dnV1aQghJ4e6Z/PmzeKcnByPF3EHAAAAAADwFMwgGgKllM6dO/fdurq69UPdY3MWUX/x55UpKctaW1sTjEZjlmdH6nlhYWH5jY2Nap7neUopDQ4O3tfU1LTclbYkEsmV1atXz9fr9c1CjxPuDBzHSXJzc88PUxfIEXxmZuaSwsJCRwuv04CAgBPt7e1RttpatWrVwl/sggYAAAAAADDGYFnEEFJSUpYPFw4R8tMsohUrVmQN/KzVapVhoaF54rvvvlJcXFziwXCIJ4TwMpmsSSwWmwd+9lBfxGg0rlKpVK9RSinP83xiYqKmv1+nSCSSK5mZmbEIh8AdRqNxjZvhEImJiXnTiXCIEEL4p556SiMSiWzOErp48WKkO+MBAAAAAAAYbVhiZoNGo5lSVlbmSKVnWlVV9SrHceWnT5/OOnHixEsWi8VX4OHwhBCiVCqrfX1923x9ff9boVBU33XXXZaurq46juN8V61aFfrjjz/6dXV1Bbe1tUWbTCYVcaDekTOqqqpei4mJIYSQ13U6XcfFixfTCSGHHH2eYZgLq1evjkc4BO4QYueygICAky+88ILTyxvz8vIa586d+z4hZHBwTK9evfqQO2MCAAAAAAAYbQiIBhmoO+Ro0GM2m5X33ntv/Q8//OAv8FB4QggfFxe3ISwsrMBkMtks5Nxf4Lna+lxWVlZMRUXFpvb29kgiYFBUVVX1KsuyRz744INTCxYsiHb0uYCAgJMsy8ajGDW4g1JKFyxY8Ko7halFItF1rVab7kq9IJ7neY7j3hGJRGsG1yXrD2UBAAAAAADGLNQgsuJI3aERwDMMY4qLi9swXAFsRyQmJq6qrKzc1NPTIxdiYEqlsnLNmjXxp0+fXrF3794iBx7hY2Ji3qyqqnpdiP7hzqbVaifv2LHjazd28ePj4uJeLC8v/5urYxjqM0IqlXb09PRMdrVdAAAAAACA0YYaRFYcqTvkSQzDmBYtWvQyx3GPuRsOEUJIaWlpfnZ29nyGYUwCjO1CampqUktLS3hpaand5XcSieTKqlWrFiIcAiFQSmlNTc0mN8IhIpVKOxcuXPi+O+PgeZ5/7LHHCgef7+np8WNZNtSdtgEAAAAAAEYTAqJ+TtQdEpxIJOqNjo5+m+O4R48dO6YTcrtsvV5vyszMjHUnJOovLh3f09Mzsbi4eJ+9L+kymey8RqOZhV2dQCjp6elPu1n0nVepVG8K8d7Ky8trnDNnzm1B04ULFxa72zYAAAAAAMBoQQ0i8lPh27KyMofrDgmFYRiTQqGo1mq1b27ZsqXNU/3o9XoTISSWYZgKs9msdPLxWykpKek3btz41+7duyvs1X9RKpWVarU6CfWGQCgcx0kcmbU2nKlTpx5uaWlxa/bQAJ7n+YyMjDJCyBqr0/TSpUszhWgfAAAAAABgNGAGESHkmf+zy3Ljxo27R7LPmTNn7mZZNtxoNGZ7MhwaoNfrTSzLzg8ICKh14jE+Li5ug0Qiqd+9e3eFna3F+YiIiB1r1qxBMWoQDKWUnjhxwq3C1OSnWlivCDYoQkhRUdERpVJZbX2upaUFM4gAAAAAAGDMwgwiQsjjNy/ysRkZrxAntm13R3h4eN7Zs2fVI9GXNZ1O10EIiVUqlQdNJlOMvfsjIiLeCwsL++DQoUP2wqFbcXFxG+rr610u/gtgS05Ojt/WrVvdqgvWXyi9UagxEfLTLKK4uLgyQohq4NxIz0AEAAAAAAAQEmYQ9SsqKjoSERHxnoe74SMiInY0NDSMeDg0QKfT9aampqbbq0mkVCorw8LC/q/Kysp97e3tkUPdJ5VKv83MzIx3Z2coAFsopbS6uvoldwpTh4eH53mqULq/v3/14HOZmZmYRQQAAAAAAGMSAqJ+PM/zp0+f1oSFheV7qItbS5cuXVtfX6/xUPsO0+l0HZmZmbFSqbTD1nWGYS489dRTGZWVlUWtra1DfuENCQkp0Wg0jxUWFh7x3GjhTrV69eqQM2fOrLF/p20BAQEnU1NTPfZ+MxgMjWKx+BfLKe3MtAMAAAAAAPBaWGJmhed5/ovx/mq5XB7a0dERJlS7Uqn022effTbpk08+qROqTXfp9XrT1atX0wkhldbnJRLJlWeffTa5srIyb7hwKCoq6t2mpqYNHh8o3JEopXTatGnubGvPL1myRCPkjoC2BAQE1BFCBt4n9OLFixGEEEGKYQMAAAAAAIwkzCAa5PGbF/klS5YItgQsOjr6bY1G81hubq7XhEMDCgoKquVyudHq1K3ly5evqqmpeWu4cCg6Ovqt2tpahEPgMenp6U83Nzcvc/X5iIiI93NzcwWtO2SLv7//KeufUYcIAAAAAADGKswgsiEvL6/xyy+/fK++vv6PbjTDR0REvFdfX/+yYAMTHr9kyRKNSCSq6OvrEy9atCinra3tj8OFQzNnztx99uxZQXeEArD2xXh/+l+yG5tcfV4kEl3fsGHDm0KOaQj8ww8//Jn1CZPJpBqBfgEAAAAAAASHgMgGnud5SqkmKChI0dra+rSzz8tksvMrVqxIr6+v9/gMBncZDIbaixcvvjxnzpxphJBHhgmH+OjoaF16evpIfPGGO9jLix//Y+fBg6EuPs4vXbpUo9PpOgUd1BDuu+++X7zHMYMIAAAAAADGKsrz/GiPwWtxHCcpLy/fbjQaVzn6zPjx4/teeOGFaXq9fthdwgghlBBC1Gp15M2bN8Vms1nBMEzb+PHjLQaDYWA52oj85WzevFlcWVnJDrUTmVQq/TY5OTk9Pz+/eiTGA3curVY7OTc39x+uBi1Tp0491NLSEi/0uIZBCSG3rH7mWZYNH4nlbQAAAAAAAELCDKJh6HS6XkKIxpmi1Tdv3hQxDFMhkUge63/+Z5RSunbt2uCurq7gs2fPZjY3Ny8zGAy3tSESiSwKhaJ6ypQpR4ODgw9s27atjfdgknfy5MlnhwqH5HJ5A8uySVu2bGnzVP8AhPz0/ggNDd3kajgkEomua7Xa0d4lkLa0tCwjhCAgAgAAAACAMQUziByg1WqZQ4cOFTmz3CwkJGT/U089pdbr9eb+YEh59OjR7cPV9xmKUqmsWrhw4QaDwWC0f7dzkpOTn927d2+RrWtyubzh+eefj9XpdN22rgMIieM4+datWy+4uHPZrRUrVqhLSkoKhB6XHYNnEBGlUlllMpkWjvA4AAAAAAAA3IKAyEGUUqpQKCpMJlOMo88wDGNatGjRBpPJ9NTp06fXuNO/WCw2JyQkqD/++OMDQs0mUqvV4YWFhSdsfSFHOAQjiVJKVSrVa1VVVa+58Di/aNGil48dO6YTfGD23RYQEUJ4rVb7qF6vbx6F8QAAAAAAALgE29w7iOd5PiEhIWnQtsgDO1MAACAASURBVPDDMpvNyuLi4hJ3wyFCCLFYLExxcXFJYGDgQY7jJO62p1arw0tKSvbZCoemTp16COEQjKTnnnsuxsVwiISHh+ePUjg0FHr27Nm00R4EAAAAAACAM1CDyAl6vd48efLkedHR0a/W1NRwpL/Q9EhqbW19WiaTnent7Y13oBC2TRkZGUs++ugjW+EQHxER8V5LS8to13GBOwjHcZLDhw9vd+VZpVJZaTKZ1EKPyVEcx4l1utuzqc7OzpmjMBwAAAAAAACXYQaRk3Jyciw1NTUvJyYmqonzu4zxQxxO6erqCiksLKzQarVKZ59Vq9XzhgiHbi1dunRtfX09wiEYUUajcU1XV1ews89JJJIrSUlJoxYOEUJIZ2dnpK3zJpNJNcJDAQAAAAAAcAtmELmotLQ0f9WqVaa6urp1TU1Ny4a7Vy6XNyoUiuqAgID63/zmN53W13788Ue/rq6u4M7Ozpn97Tg0K8lsNiulUumJq1evphcUFFQ58oxGo5lSXFx8WzgkEomuP/PMM0mffPLJEUfaARCKVqtlTp48+ZILj/KJiYnq0dxdr79u0pO2rlksFt9Vq1ap8vPzq0d4WAAAAAAAAC5BQOSG/i9/1QM/b9y4UfH9998r7r///jbrL64dHR0OtafVapVHjx7d2tTUtNyR+3t6euQikejg9evX04uLi/cPd69Go5mye/fuip6eHj/r8wPhUGFhIcIhGFGUUjp37txXB/9OOiIgIKC2vb39gCfG5ah169b5FhYWPj/EZdrW1qYiVp8PAAAAAAAA3gy7mHkZSil94oknNtXU1PzZicf4xMREdWlpab6tiyzLTiwpKTkxeBkPwiEYTcPtojccb9lhLzk5+Zm9e/fuHuq6XC43dnR0hI/kmAAAAAAAAFyFGkRehud5/vjx46/MmTPnfSceo6WlpYaVK1feNvOIZdkJlZWVRQiHwJtotVpmqF30hiORSK6kp6cnjXY4RCmlX3/99VPD3dPR0RGalpY27PJTAAAAAAAAb4ElZl6I53leq9W+QwhZ48RjdP/+/UVZWVnxAzWJWJadePTo0X2DC+YiHILRNLC0zGw2K5x5TiQSXc/Ozo51ou4QJYQQtVodevPmTd+Bk/fdd1+bqzsADsjOzg41GAxZ9vq/dOlSKCFkVJfCAQAAAAAAOAJLzLwUpZSGhobmGY3GLGeeYxjGlJmZGXvjxg26e/fuisFfwhEOwWjjOE6+devWC07OHuJXrlz5bHFx8R57N1JKaXp6+uITJ068NMRuYjxxY/YkpZTOnj17x+nTp+0GuBEREe/V19evdbUvAAAAAACAkYKAyIup1eowg8HQ4Oxz995778Vx48bd6u7ufsj6PMIhGG3OhCvWYmJi3qiqqnrd3n0sy05oaGjYaqd9twKirKysmKKiokOOBFwikah3w4YNk0d7SRwAAAAAAIA9qEHkxWQyWacrz/3www/+CIfAGz333HMxzoZDcrm8wZFwSK1WzystLT3hSPsbN25UODOGAZRS+tlnn73q6Oynvr4+8Y0bN3zt3wkAAAAAADC6EBB5MZ1O1xkQEFDnbjsIh8BL0KNHj2515gGRSHQ9ISFBY+8+tVo9r7CwsKKzszPU9eHZl5CQsGqIZWsAAAAAAABjGgIiLxcYGFjuzvPjx4/vQzgE3iArK0vlZIDDL1y48JXc3NxhQ1K1Wh1eVFR00JmaRt9//73CiXH8hFJaWVm5ydnHXOoLAAAAAABghCEg8m783Llzc8Viscv1S27evOlz7do1PyEHBeCsgaVZzjwTEhKyv7y8/G/D3cOy7KNFRUUVFovF48u4kpOS0np6epx+L3377bcendUEAAAAAAAgBAREXu6Z/7OrUyqVulSLqB91djtxAKGlpKQsd2ZpFsMwFxITE9XD3UN/mtGz1ZVw6OrVqwpn7qeU0i+++CLT2X4IIfRf//oXahABAAAAAIDXGxMBEaWUarVahlJKR3ssjqIOcLQtf39/l+sQKZXKSkcK/AJ4CsdxkqqqKoeXZjEMc0GtVscOt/MXpZSqVKrXWltbF7swJHrmzJlsjUYT4uj7cO3atcEu9gUAAAAAADAm+Iz2AOwZ+CKo1+tfKy8vP6BWq98xGAy1oz0uQsgvvlhyHCfu7OyMJIQQs9msUCgUw842eOCBB5rj4+PPymSyZkIIKSgoqO6/xFvf9/jNi/wjyclHCSFZzg5QKpV+q9Fo0p19DkAolFK6YMGCV7u6uoIduV8qlX7Lsmzsli1b2oa7Lz09/eldu3a95uq4vvnmmycIIedPnjyZz3GcRqfT9Q53/48//ujqMk1+0qRJjS4+CwAAAAAAMGK8PiDKzs6OMhgMrxFCSHNz8zJCSGJycnL63r17P/R034NnF6xbt8736tWroR0dHaFXrlyZevny5eDe3l7fzs7OUJ1O52zzKusfRCKRJTg4+MBDDz1U89aRL94n5KdwiBBCAgMDD4jF4m5nltKIRKLrGRkZ6Tqdzp3laQBu6X//cg7ezicnJ6fbC4cIpbT8gQec2g1tKEajcVVISIhvb2+vWq/Xm4e6z9GAyxZ/f38ERAAAAAAA4PUoz/P27xolLMtOLC4uPjO4ho5YLDanp6fHGgwGo5NN3racRKvVKmzVIzGbzYoffvjh4d7e3vsuXboUSgghFy9ejHRmpyRXMQzTNn369D3h4eHvDHxpjYuL+4/y8vJ3HWyCj4uLe9FegV8AT2JZdkJJSckZR8OV8PDwvIaGhmHrDhFCyMqVK5cXFxeXuD/Cf5NKpR2JiYnqXbt2HR58bWAWY1VVlSszlviNGzdOsRt6AQAAAAAAjDKvnUFEKaXTpk0z2CqwbLFYGKlUelAmk4XbmiEzMPNnYMYPIYR0dHSENjQ0rB78ZVWv13voFbiu/zVzDMOkEkJi9Xq9KTg4uMDHx0d348aNu+w9HxISsr+pqQnhEIwaSimdO3fuJkfDoYCAgJMvvPCCxt59X4z3H1cju+HUbmiO6OnpkYtEon2EkKTBIRHP83xcXNxVofsEAAAAAADwJl4bECUkJKwqLS1dNtT1np4eeVRU1EuEkBcHzlFKaXZ2dqRKpYq7du3apNzc3LSR2P7aU8xms1IsFp/5/vvv0wkh9NatW+PtPcMwzAWWZe3OwgDwpJSUlGXFxcXrHblXJpOdV6vV8Tk5OZbh7qOU0tDQUEOn0TjctvHWUyKdKmrf19cnGSokCgsL28MwzJ/MZrPSmTYJIcTHx2fY1wUAAAAAAOANvHKJGcuyj+bl5Z2xt5xLJBL1/uUvf5mYk5Nj4ThOXl1d/VJdXZ1DX0pd8Is/qICAgLqBL35W23d7ZJc1Hx+ff/E8T2/evCka7j6RSHQ9Ozs7Njc31+VdzwDcRin1mzSpobOzc7gghxDy0+/s2rVrZ+n1+mZ7965cuXJFcXHxPhtt9IaEhBy4//77WxQKRTUhhOTn53/2yCOPHPn666+fcnb4IpGoNzU19baQSKvVKgsLCyucCYn6Z/OtcHYMAAAAAAAAI83rZhCxLDuhtLS0yJFaP319feKsrKyo+Pj44Jqamld7enpc3WloOLxSqayePn168eTJk+tyc3MbCSGkvb39Fzdptdrg2tradWfPnk2zWCyMkANwZFkZIYRfuHDhKwiHYLStTElZ3llcbDccIoTwS5cu1TgSDrEsO6GqqmrT4OcjIiLe12q17wyu8aNWq8NcCYcI+fdMorvvvjvWesdEvV5vIoTEMgzjaEjEh4SElLkyBgAAAAAAgJHmVQHRQN0SR2YeDDxy+PDhbZcuXZou8FB4mUzWHBgYeCQiIuIDk8lk9wts/5fctRzHvRwdHf1STU0NRzw0o2hgjNbto+4QeAOO4ySHDx/e7si94eHh+Q0NDQX27mNZdkJlZeU+63pGUqn026effnpDfX39nsH399cvc6tOUV9fn4RhmKJ77rlnlvXuZs6ERCKRyLJhw4Yj7owDAAAAAABgpHhVQJSenv70rl27nFoiJnA4xEskEvPvfve7V7q6ut53pQGdTtdNCHk5IyPjeEVFxaaOjo4wAcdHCCFELpcbZ86c+f/V19f/yWw2KxiGMaHuEIy2/t2+chyZyTd16tRDarXablFqSum4adOmFbW2ti62Os0vX75cXVhYaDN8yc7ODjUYDEPWL3OU2WxWBgUFFUkkkiSdTtc7cN7RkGj69Ol7bBXRBwAAAAAA8EZeU4NIq9VOzsvLO+OhZWL28EqlsnrOnDkfTJky5Uh/yOO2L8b70z/Nn7Kppqbmz0K0R8jPRahn6XS6bo7jfC9duhR6//33t2EbbRhtiYmJ2aWlpQZ79/WHQ0kOFKUet2DBgk3Hjx/nrM9HRUX9tba29sUhnqHTpk0raW5udjsgGhAUFHS4tbV1yeDzdmoS8WlpaSv27NlzQKhxAAAAAAAAeBTP86N+EEKoQqGo4kfHzd///vdrHB2rswchhAYHB5cIMVCxWPz9unXrgj01Vhw4XD3S09OX8A4ICgo6qNPpxPbaW7169YRp06btt9HEreHeA9nZ2WE8z99yZCxOuJWSkpJmq79169YpfX19Lwx+wM/Pr8Hea8SBAwcOHDhw4MCBAwcObzrGjWo61e+pp55ab7UT2Ejhw8PD8ziOu/+TTz5xaTmZQ53wPP/UU0+pg4KCDtu/e/imUlJS0h0p6AswkjiOk5SXl2+1d59IJOpdsWKF2t7MIZZlJ1ZWVu6zNQtIKpV2Tp48uW2oZw0Gg5Fl2fCQkJD95Kc6XUJMkaS1tbXrbF3Q6/WmzMzMWIZhTFan+SeffPJNAfoFAAAAAAAYOaOdUPH8T/8X3sfHp5cfIT4+Pj+mpqYuG6nXx/M/zSQKDQ3N412c3fDEE0+8NZLjxYHD0WPhwoV/5h3gyO/w2rVrp/j6+pqGakOlUr3u6LhycnL8nnvuucX+/v4nefdnFd16/vnnY4bqy3omUXBw8D5Hx4gDBw4cOHDgwIEDBw4c3nJ4xQyibdu2tc2aNctjs3isyWSy89nZ2bEjXRuE53neaDRmx8bGvkKcnNUQEBBwMj4+HjMSwOuwLPtoTU2N3R3Dpk6desjO7zDNzMxcuHv37gqz2awQYmw6na6zsLDwSHt7+7zMzMwlSqWyyo3maHl5+dbNmzeLbV0cmEkkk8nOJyYm2i2+DQAAAAAA4G28IiDieZ6fO3fum4OWaQguPDw8r6ur67Hc3Nw6T/YznIqKirczMjLiHb1fIpFcSU1NTbe3LAdgpFFKaWVl5da+vj6bockAuVzeMFRRakopVavV82Qy2fn+gs+KYZrifXx8XHofFBYWHmlra4uNiYl5QyqVdrjSRkdHR2hlZeUfh7qu1+tNGzdunIWdywAAAAAAYCzyioCIEEL0er05MTHRY1u1BwQEnGxoaPCKreDvu+++f/r4+PyvA7fyiYmJauxQBt4oJSVl+aDt523hFy1a9IqtcEir1U4ODAw8ZDAYTnR1dQU70qdcLm90abDkpyC6qqrq9f/8z/+cEh0d/TZxvj4Rrays3MSybOhQNyDIBQAAAACAscprAiJCCNm5c2d1RETEe0K2KRKJemNiYt5IT093eNaOJ7EsO6GsrKzoxo0bd9u7NyIi4j1skw3eiGXZCVVVVZvs3RcVFfXXwsLCI4PPq9Xq8Ly8vDMOBEy/IJFIup2535acnBxLTU3NyxkZGfFisdjszLN9fX2Ss2fPZro7BgAAAAAAAG/jVQERz/P8woULNwi11IxhmAtr164Nr6qqel2n07n9xdJdGo1mSmlp6Yn29vZIe/fKZLLzSUlJG0ZiXADOoJTS+vr67fZm/YSHh+fV1tbe9jvMsuyjRUVFFT09PX7O9j1lyhSXZxANtmvXrsPr169/rH+HQYdnE507dy5tqFpEAAAAAAAAYxXleSF2gRaWWq0OKyoqqrBYLIyLTfABAQG1qamp6d6wPItSSlNSUpaXlZUZLBaLr737GYa5oFarY71h7ACDxcfHrz148OD24e4JDw/Ps7WkU6vVMoWFhQ0uFqLmiYdC7aVLl66prq5+tT+0ovbGkZycnL53794PPTEWAAAAAACA0eBVM4gGGAwGY3p6eqyzyz8IIUQsFl/NzMxc0t7ePt/RgIVacXqwdrAsO2Hu3LnvFhcX70M4BGNdYmJitqvhECGENDc3Zwm1S5mQPvnkk/d7enomJyYmqkUiUa+d2+mnn366neM4p2dAAQAAAAAAeCuf0R7AUAwGg5EQEisWi52aSfTQQw8dt1XzxMrPIVBWVpaqvb09UqVS/VwPKC4u7mpgYOCRHTt2NPNuTq/SaDRTDh06VOTIkrJ+/LJly1CUGrySWq2ed+jQIZfDIUII8ff3r5ZKpR09PT1yZ/tnGKbNbHY6M3ZKaWlp/ubNmz+Mjo5+taamhiNDzCayWCxMTEzMGkLI6x4dEAAAAAAAwAjxyiVm1tRqdVhhYeGJvr4+iYOP8LGxsa9UVFS8bX2SUkrXrVsnr6mp2dTd3a0wmUyq4RqZM2fO+w8//HBNYGDgAZ1OZ29GwW20Wu3kwsLCE87MlggJCSlpampKcrYvAE9jWXZCSUnJmeHqDtkLhwZotVqmpqZmq9FozCL2l3P9LCwsLN9oNGY7er+7EhMTV5WWlhrIEGOUyWRNXV1dj47UeAAAAAAAADyK53mvPxISElbxPH+Ld9ytJUuW/JH0B2CN4x4ct2DBgrd9fHx6nWiD53mev/vuu80LFy78c05OjsTR8a5evXripEmTjM70IxaLv8/JyfFztA8cOEbqIITQ2bNnv8cPIywszOBsuwkJCavuvvvuK8O1ay00NDRvpF+7nc+eW1lZWaqRHhMOHDhw4MCBAwcOHDhweOLw+hlEA1auXDlQ5Nnh5WZKpbJ6ypQpR2tqal7t6+tza9chmUzWlJCQoM7Ly6vjh/lDY1l2YmlpaUVnZ2eoE83zK1eufLa4uHiPO2ME8ITMzMyFhYWFFUNdd3TmkC1arVZZUlIysAxz2NlEMTExb1RVVb3uSj/uGG4mUUhIyP6mpqYVIz0mAAAAAAAAoXllkWpbiouL9ztbuNpkMqkqKirecjccIoSQrq6uEIPBcPKJJ57Y9MV4f5tfZLVa7WQXwiESHh6ej3AIvJFGo5myf//+oqGuuxMOEUKIXq83tbe3z4uNjX2FDL/VPM8wzAVPFJK3p7S0ND8xMdHma/zqq68WY8t7AAAAAAD4NRgzAREh/97dTCaTNY3WGGpqav78+8n0BMdxPxfZpZTSRYsWvbhjx46vnQ2HZDLZ+dTUVI3wIwVwD8dxkn379u3r3/r9NjNnztztTjhkraKi4m21Wj1/mB3EaElJyc7Q0FADx3HykQ6KysrKCiIjI/82+HxfX5+4srJyzUiOBQAAAAAAwBPGVEBEyE8h0bPPPjs/JCRkPxl+xsFg/DCHU9rb26Nyc3NPaLVaJaV03IIFC946duzYVmdnKolEouvPPvtsUk5OjsXZMQB4EqWUnjp1KmeowFOpVFamp6cLEg4NaGtrU9krRm80Gldt3br1wowZM4q0Wq1SyP6Hw/M8r1Kp3pFKpR2DLtHz58+vHKlxAAAAAAAAeMqYqUFkS1pa2rJ//vOfCefOnUuzFc4olcrqgICAuvHjx//rrrvu6lYoFHW5ubl1A9c3btyouHDhgspsNit+/PHH3zY1NS1zZvvtBx544J8TJ078qqWlJd6F4d/KzMyMLywsPOLCswAepVarw/t3D7ztfSWXyxuef/75WJ1O1y1UfyzLPpqXl3fGmZCVYZi2iIiIbe/81z/+9vjNiyPyQbZy5crlxcXF+8gv6xHxq1atWpifn189EmMAAAAAAADwhDEdEAltYElNa2vr0x7uio+Li3uxvLz8tiUrAKON4zhJQUHBSVuzhzwRDn0x3p/+fjI92V+o2mkymax53rx575SWlRWQEfhA6y9anWd9Lioq6q+1tbUverpvAAAAAAAAT0FANAillCoUigqTyRTjqT7kcrmxo6Mj3FPtA7iKUkoXLFjw1vHjx7nB1xiGucCy7CwhwyFCCImNjf1zRUXFW+62I5PJmuLj4zU7d+6sHm6nQXdRSum0adNKmpublw2cE4vF5jfeeGMylosCAAAAAMBYNeZqEHkaz/P8woULN3iyiyeffPJND7YP4LLnnnsuxlY4JJFIrmRmZsYLHQ6xLPtoTU3Nq0K01dXVFVJQUFA5ffr03RqNJsRThax5nudnz579gfU5i8Xie+rUqTRP9AcAAAAAADASEBDZkJeX1xgUFOSR2kABAQG1e/bsOeCJtgHcodVqJ3/yyScGG5dupaSkpOv1+mYh+/tivD89dOiQwdni7vZ8+eWXadu3bz+/YMGCtziOG7botav8/f2rpVJpp9UpajQaMz3RFwAAAAAAwEhAQGQDz/P8/Pnz3/FE00uWLMGW9uB1WJadUFJSss9sNisGXeLj4uI2eKKY+ouqaZyrdYcccfz4cW7nzp0nOI6TCz2baPPmzZbZs2fnWp8zmUwqrVYbLGQ/AAAAAAAAIwUB0RAKCgqqAwIC6uzf6biQkJD9ubm5jUK2CeAulmUnVFZW7rMV1oSHh+cLXUyd9rvnnns6RSJRr5BtD9bR0RH2t7/97fzcuXPf5TjO4R0K7eF5np8yZUrpoNO0vr5+tVB9AAAAAAAAjCSf0R6AN3vwwQfrCCGCzHAICQkpSUxMVAvRFoBQKKU0MDBwX2tr6+LB15RKZeWaNWsEmfH2xXh/SgghLy9+fI1KpZpECCE3bty4lJiY+AeRSPT/9vX1eWQpGCE/1QcihKxnGCaxs7NTXVBQUCVEuwaDoZFhmDbrWVd///vf13Ac945Op+sc5lEAAAAAAACvYzcgopRST+4I5MX4hx566DghZL27DUkkkitarVYjdIFfAHf97ne/+49jx47dFg71b2ef5O6uXJRSmp2dHXki6J6Xvv/+++Cugwd/sQRrxowZe9LT0+PFYvE+i8XCuNOXPWazWSkWi/eNHz8+1mAwGIVoc/r06XsIIT8X9e7r6xOvWLFiMSGkQIj2AQAAAAAARsqwS8w2b94sVqlUr2m1WqWndgQSAHXzsEmtVoeXlZXlCTA+PiUlJR0zCsDbqNXqedXV1ZsGn+8Ph2LdDTS1Wq1y7ty57xoMhpPNzc3Lurq6bqvPc+3atUkFBQVVLMvOCggIqCWEeDSMtlgsTGFh4YnExMRVAnym8RMmTPhu0DkUqwYAAAAAgDFpyICIUko//fTT16qqql7bsWOHR3cEGsaQwY5GowmJj4//44wZM3b7+fk1EEJuOXMwDHMhLCwsLzk5+Zn+1/VzYKTVaicXFxcftFgs9wnwGvjJkyc3CdAOgGC0Wu3kkpKSosE7iDEMc0GIcCg5OfnZHTt2nK+rqxt2Bt61a9f8CCFEr9eb2tvb5y1atOhluVxuJB4Mivr6+iSlpaV5c+bM2e5uSBQYGHhb8W4UqwYAAAAAgLGIDrV6LDMzc2FhYWGF9TmGYUwcxz3q4rITh76IabVa36tXr4YSQsg333zzJCGEdHd3P9zd3a24du2an61ZCELw8/NrDAoKOvLoo49uO3r06G6TyaQSot1JkyZ98eKLL0a6u1QHQChfjPenv59MTw4uSi2RSK6sXr16vrvb2cfHx689ePDgdkfuvfvuu3v+8Ic/zN2xY0ez9VJWlmVDW1palrW1tUVbvRcFn8UYFhaW39jYqHZjGS0lP4XOt7VrNBqz3RsdAAAAAADAyLEZELEsO7G4uPiMjS2vSXR09Ns1NTUv22t34D+0Wq3i3Llzabdu3brb+oampqbEzs7OUBfH7TE+Pj7/e+PGjbvt32nf3Xff/cOf/vSnx7ds2dImRHsAQoiNjf1zRUXFW4NO31q1alVsfn5+tTttq9Xq8MLCwhODZybZExYWlh8XF/eKTqfrsHV948aNioqKile/+uqrxT09PX5Wl9wOjdwMiWwGRCKRqHft2rUP6vV6s7vjAwAAAAAAGAm3BUSUUhoaGppnNBqzhniGZ1k23MZ27ZQQQtRqdeg//vGPzMbGxqz+3YPuVHxaWtqKPXv2HBjtgQAMGCLA4ePi4l50dzt7lmUf3blz5wlX3/disdicnp4em5eX12gvrNm4caPiwoULKrPZrPjxxx9/29HREWo1I8rp0MiNkIgyDHPBVpgeFBR0uLW1dYmzYwEAAAAAABgNtwVEycnJz+7du7douIdmzpz54dmzZ58d+Fmj0YScOXNm9T//+c9ltr4o3YkiIyO31dXVaUd7HAADtFrt5MLCwhOD36MRERE76uvr3drO/ovx/jROdqNBiFmB/bOJNDqdrteZ5zZv3iw2Go2Lv/nmm+ivvvpqsdVyVIcCIxeXhdGwsLChAnWe47iJ2L0QAAAAAADGgl9sc6/Vaid/+umndmuHNDU1LdNoNCGr3y9tfnnx4388evToVmeXlDiIJ4QQhmHafH1928Ricbefn9/ZgYvff//9VLPZrHBn5oAn+Pv71/3pT3/KGe1xAAxgWXbCoUOH9g0Oh6ZOnXqopaXFrXCIEEJeVE3jOisqBFkyajQaV8nl8tCenp707du3O1zgvb/O14H+40WtVht84cIF1eeff/5S/+se9vPBaDRmxcXFfVleXv5Xt17Av9FTp06tJ4S8LlB7AAAAAAAAHvNzQEQppYGBgQZHlof09fVJQkJCNpVNpvL2gwcj7d3vJF4sFndHRUVtUygU1ZMmTWo0m83D/h94juP8WlpaFldVVb3qyBdBT7rrrrt61q1b9wyKUoO3oJTS6dOnGwYXpZbJZOfVanW6u+2r1erwmpqaV91tx1pHR0eYWCw+cfXq1fRdu3YddqWN/mLbzYSQ91etWqVqbm5OqK2tXU+G/nyglZWVm9RqdbXBYDA62A0/ceLElqEufv755y9xHPe+TqfrdHL4AAAAAAAAI+rnJWbO7DzkIfzMsi8PuAAAIABJREFUmTP3zJo164NJkyY1u/KFavPmzeL/+q//Wl9dXf1qX1+fxBODtIPPyMhYvGvXrqOj0DeATbbe2xKJ5IpGo5nlbgH1/mD5UGtr62K3BjkEkUjUm5qamuRqSDRYRkbG06WlpYaenh75UPcEBATUtre3z3O0zcTExFWlpaV5Q12Pior6a21t7YvOjhUAAAAAAGBE8TxPVq9e/aiPj08vPzpuBQYGHlq9enUkz/NEiGPdunVKHx+f6yP9QubPn/+WUK8BBw4hjiHe27dSU1OXCdF+QkJCNu9hPj4+19PT058WYrw8z5N169YxCoWicpgub2VnZ0c52l5CQsIqe+Nfu3ZtiFDjx4EDBw4cOHDgwIEDBw5PHD4cx0kOHTpk8FANoWEFBQUdXrBgwTutra3VQrar1+tN165di2UYpshsNiuFbHsocrm8oaOj4+WR6AvAEWq1Ory4uPjg4Pd2eHh4fkNDg9u767EsO6GysnKTu+3Y09fXJxGLxUX333//LL1eb3K3Pb1eb5ZIJOkikejrIWYa0qKiooNTp06dLMRS0b6+PklQUNBWQgh2NAMAAAAAAK817tSpUzmDa5N4mkgk6g0PD8/7wx/+sCI/P7/aE30YDIbaxMREtUgkcmonJFeIRKIfn3/++XhP9wPgqIyMjCWFhYUnenp6/KzPT5069VBqaqrbRakppfSLL77YNLh9K7yNw2UWi4UpLi7ep9VqGXfaGaDT6ToSExPVQ43LYrH4Go1Gh5bNOVK3ra2tTaXRaEKcHCYAAAAAAMCIGff555+P6G5bUVFR7/7lL3+Z2NDQoPZ0IeeCgoKq1atXzwoKChKkfskQbqWmpq5AEVrwFmq1Ovyjjz7aN3jm0NSpUw+p1eokId532dnZUXV1desHnxeLxeaIiIj3VqxYkU0IGTdwcBz3m3vuuec7d/rs6OgIKy4uruA4TpD6Ynv37v0wNjb2lSEu0zNnzqx2oBn63XffzbR3U19fn2QkZlsBAAAAAAC4apy/v3/dCPXFx8TEvFFbW7thJHf42r59e1NSUlLSI488Injh6ICAgFqWZWehKDV4C61WO7mkpOS2cIhhmAsrVqxIF+K9x7LsxMFFr0UiUW90dPTbLMvOq6+vX1tSUlJgfd1oNK65du3ab93tu6OjI6yysnKru+0MmDNnzt+kUmmHrWudnZ2hmzdvtrv0tqOjI9SRvr766qvFHMfZnW0EAAAAAAAwGsY9+eSTb3q6E4lEcmXFihXZVVVVr3u6L1s2b95seeCBB4bcitpF/Pz589/Jzc1tFLhdAJewLDuhpKRkn9lsVlifF4lE15ctW6bW6XTd7vZBKR139OjRfZ2dnT+HIiKR6Pozzzyzoqam5uX+reV/geM4ycmTJ19yt+8B9fX1a9RqdZgQbel0ut6FCxfanEXU09Pj9/nnn2fZa8P6z2I4fX19gv45AAAAAAAACGnczp07q6Oiov7qqQ4kEsmVzMzM2MEzCkYKpZSqVKrXTp069YKQ7U6dOvXwnj173C70CyAESimtr6/fPrieWH94kyRErS9KKV2wYMEmk8mksjrNL168eENhYeGRoZ67cOHC4p6enknu9m89lMrKyq2OzO5xRGlZWYGfn5+toJdeunRp2OVjWq3WqRlB9fX1a4QaNwAAAAAAgJDG8TzP19XVbZg5c+aHQjcuk8nOZ2Zmxo7mLJuUlJTlVVVVrwnZZkBAwEm1Wp0kZJsA7vjd7373H0ajMWvQaf6ZZ55JGi68cRSldJxKpXrt+PHjnPV5pVJZ/cknn7w/3LPFxcX7N27cOCUsLCxfLBabiZsFqwkhxGQyqWpqala52w4hhBCe52fNmvWBrUv2ClC3tbUtc6Yri8Xie+bMGaeeAQAAAAAAGAnjCCGE53l+yZIl6qFqcbgiKirq3Y0bN84azXAoIyNjyf79+4uEbJNhmAupqamC1HIBEEJiYmL2sWPHbqvLExUV9VchwiGWZSfMnTt3q42glVepVA4tUd2yZUub0WjMtlgsE1mWnRcREfEecS8oohUVFZs2btyocKONn82YMaNAJpPdtjyuqalpGcdxNndqo5TS8+fPr3SyK1pbW7vOpUGOPls703nzAeAs/M4559f45+Vtr2m0P0d/Da/fk7x9fAAAThs38B86na43KSkpXYA2R6UY9WAsy04oLS01DC7W6yY+Li5uw5YtW9oEbBPAZYmJidmlpaWGwedlMtn5ZcuWDbVDl8NYlp1YWlp6wtaOZSKRyDJp0iSnA+Dc3Ny6+vr6tSzLhoeEhOwnLv4DyWKxMDU1NYLU9Nm8ebPF1jKzvr4+8aVLl4JtPZOTkyNua2tTOdtXd3e3wvkRjqqx+o/YsTpuAICx+vk1VscNAAD9xln/sHPnzuro6Oi3XW1MLBabFy1a9PJoFaMeQCmlDQ0NW3t6emz+n39XBQQE1KLuEHiLocIhiURy5fnnn493N6DtD4cqhirCrFAoqt0pfJ2bm9vY1NS0IiMjI14ulxuJC/+o7C9YHeXqGAbwPM9HRERsc+aZrq6uUFcC6J6eHj+WZSPt3znqfi3/0P+1vA4A+PX7tXxe/VpeBwDAHecXARHP8/zx48dfCQsLy3e2occee6zYYrFMPHbsmM6B2+kwh9tSUlKWnz59eo0QbQ0QiUS9K1asUAvZJoCrMjIyltgKh0Qi0fXMzMx4d2a5UUqpWq2eV1JScmK4Hbr8/f3rXe3D2q5duw53dHSEJyYmqvtrFDmDVlZWbhJiHAaDoc7WLKLLly/bnEE01HkH0KampgQXnwUA+LXwtgDB28YDAAAw4sYNPsHzPN/Y2Kh2NiS6cuVKEMdxkiEuU0IIzcrKilm5cuXyyMjIdwMCAk4SQm4NHAzDXIiMjHw3IyPjaUKpy0ERx3HysrKy2744u4lXqVRv2trCG2CkqdXq8I8++mifjUv88uXL1bm5uXWutEsppRzHyRcsWPCWwWA40dXV5WoA4pLS0tL89PT02P5aaA7/Q91kMqnS0tKEKPzMP/7444WDztHPP//8JY7j5AK0//+zd/9RTZ134Pifp5KZuGYSK5N0ZkusIFh0gFWhWsqPKoorqCBioRS452us2Ze4wmnu2p3++q7tZd/aGs/Blp5vkHHEKkMUN1HaYRCrUCxEqQoVJ6yxBhdr6NJJtrTe7x9CPzRNyK97k5vwfp1zT+vNvc/zfm5ufr15fnxvYGBgDZPlsSAYfygFY5sAAMEjGN+jgrFNAAAQ1ELs7aRpmiZJUiGRSKL0er1LwzcMBkNcWFhY9+jo6Dq1Wj2I0L0fnKWlpaE9PT3Pnz59mqypqXF4vslkkiKEdiCEdvAbGkZWpKX9aenSpbsoihp1tTEYY7x8+fLnna085C6ZTKYdHBx0pWcUAKwiCCK+rq6u1d7QpqSkpDfb29sPeFIuSZKClStXvkRRFOn8aIQQQrQn8w85o9FodJGRkfPS09O3nT179nmz2exKYgZ3d3dvRQh5PfwzLi7uPaFQ+PzE4akmk0kWERGhQQhlf/9+hDG+vXJlpKf1jL3fAQAAAAAAAAB30DTtcCstLRWFh4f30G64//77b+Tn568tLS19MCYm5oOQkJBRd863LSszM7MYIYQni3N8e/rpp1M9rWsSd1UqVbgr9cMGG5tbSUlJ/PTp0020HZGRkYc8LXfr1q2z5syZo7NX7iTuFhUVJbPZXpVKJYiNja2mafquK/GUlJTEeVsnQgg/9thjb9irIDQ0dDAzM7OYRgjTCGGpVKp17VLZj7esrEzqbbwsbcHO39cXNu5u3vJ3/IF2vcb5ux1caEuw8+d14fp94+97HzbYYIPtB5vdHkTj1Gq1CSGUJhaLWw0GQ5wrCaexv/g3e5u4mlBWdURExCaSJAmKogyOjiVJUsD0kvYIIbRgwYLDn3/++TDT5QLgjvGeQ/Z6x82ZM6fnueee82gFQmcTUfsTRVGjFEWVZGVlnT558uTrTnoT4Q8//LASIfSoN3XSNE0jhF5ECP3e9rGxXj/VIpHopaSkpNfuu3jxf97UBQAAAAAAAABc8qM5iGyp1WpTbm5u2tgqQ34xMDCwtqqq6oxSqZQ5Okan021jetUykUh0raSkxKMf3gAwRS6Xz2hsbDxkLzkkEAhuP/3009merFhGkqTAm+TQz372M58kTpuamvZ+fGfmL8ZWWHQ4n4Fer09ganUwiUTS4egxk8kkbWpqqh4aGkploi4AAAAAAAAA4IJJexCNU6vVJoFAsCIuLq5Sp9MVIYZWG3OHyWSS8fn87i+//FLR0NDwwcTH5HL5rLNnzz7PZH18Pt+0ZcsWwtulwgHwhlKpfPDDDz+sczBnDb127doyT1Yswxjj5ORklafJIaFQOGw2m302afuvv7tOtyP0QlZW1kBLS8tOi8UisnMY7ujoKEUIeTRJ9wT0xo0b83k83uXJlrH/7rvvXHr/BAAAAAAAAIBA4LQH0TiKokZ1Ol0JQRBLZDKZFt37S76jv+bTCCGax+ONymQyrUwm0yYmJr6TkpLyakpKyqtjf52nnZTxIxaLRdTQ0FCXnp7+Ozy20hnGGHd1de1kuvdQYmLi7r1797YxWSYA7pDL5bOqq6u7BwcHk+09npiY+E5jY2ONJ2XTNE3PmDHjJvJwhZGQkBC/JE6bmpr2pqWlvejo8StXrqypqKhwmNRx1e7du4eio6MPe1vOZMxm80w0tsIjm/UAAADH+XulK3/XDwAAAHAGvjflhvvKy8ulX3zxRYK9pbB/8pOfjEil0k5XlttWKpVRHR0dpV1dXc+6U39KSsqrWq32FaVSKVOr1dfcOdeZsLCwy+Xl5Uug9xDwF7lcPuPkyZOHHC2HHhkZ2XzlypV13tZDEERiY2Njnclkcjh80x6BQPBV5/8eCPv1d9d9/sV6rPfTy1qt9mU7D9Pr1q1THDt27F1v61EqlaLa2tpud6+NOyQSSWd4ePj5xYsXv19dXX2e9vQNmVlciIFNkJADjnh770+1e4vJ9wp/XjsutAPed+1j4rqweW9xPT4AAHCbxwkiRoOY/AefI3RWVhbxxRdfJI0Ne2MKXVhYmFFbW3uCwTIBcJmz5NCcOXN6iouL0yiKGmGiPqVSKWpvb9/p7vBRiUTS+fjjj79WV1d3wteJjcneM/h8vmnHjh3zmLg+SqVSVltb28pmkmhcRETEiYULF9ZLpdK23bt3D/kxWeT/DwV2wZdx4AgkiNzDhcQKE7jQDnjftY/rCRiuxwcAAG7jRIIIoXs/+B555JE9586d2+bqOdOmTbN+9913PCbjSExMfLujo6OMyTIBcJWz5JBQKLwhl8tXeDLvkDO5ubkbjh49qnEwv49DixYtOpCUlPRaZWVlP/Lhl1yMMY6KijrU19e3weYhmiCIFRqNxuFE0+4oKipKqampaUU+/BK3bNmyd1NTU8soihr1VZ0TcONDgT3wZRw4Agki9zD9XuGP68eVNsD7rn1cT8BwPT4AAHCby3MQsY2maTotLe01Ho/n8rAuppNDYWFhl9evX+9wfhMA2KRQKOY1NTWdcZQc4vF4d5566qlsNpJDCCFUX19/eMeOHQ9HREQcR2586fnss8/yKisrL0skkrNZWVnF4/ODsY2maTo1NfVFPp9vsnkINzc3VzJVT01NjTYrK4tAPvwC39XV9WxdXV1rUVFRiq/qBAAAAAAAAExtnOlBhJBnvYgYRBcXF6fCxNTAH+Ry+Yzm5uZWvV7vaJl2euPGjSWeTkrtrnXr1j3b0tKy69tvv/2Ju+fGxcXtTU9Pf5GiKAMbsdly0MOH8ddzVlZW8SQrqLGCx+ONbt68OXvfvn3HfVUn4vZfRLkcGwh80IPIPVzpfeMNrrSBy+9t/oyNy9cFIe7HBwAAbuNMDyKE7vUIWLx48fv+qDsxMXEXJIeAP4z3HJokOYTi4+P3+io5hBBCc+fOPfiTn/zk356cq9Ppinft2nU5LS3t9yRJCpiOzVZNTY123bp1Ctv9t27d+tEE+t5oamrau2PHjofHVnH0CavVKjh48GCjr+oDAAA/8vVfLLnzF1IAAACAIziVIEIIoerq6vMymazNx9XSK1as2O3jOgFACoVi3v79+1uHh4djHR0TFhZ2efPmzT9KgLAFY4x7enpev3PnzmxPy7BYLKGtra1vaDSa7oKCgrVsDzt748SF9yQSycRVE3F/f38m0/VQFGXYvHnzusWLF3+AfPTjwmq18n1RDwAAAAAAAGBq41yCiKZpeuHChfW+rDM+Pn4vW/O6AODIeHLIZDJJHR0jEAhuP/XUU9kqlcrlubm89fTTT6cwNczTaDRG79u3rzkmJmY/QRBxbCWKfv3ddToyMvLoxH0DAwNrysvLpUzXRVHUaG9v71NyuTw+Ojr6MIK/QgMAAAAAAACCAOcSRAghtGjRoiO+qksoFBp82TsDAIRcSw4hhOhNmzblq9Xqfl/FRZKk4Pjx44xN8Dzus88+y9NoND0rV658g61hZ0uXLq2xmeQenzlzppSNuhBCqKqq6nxfX99GgiCWiMViHVv1iESiQbbKBgAAAAAAAIBxnEwQVVRUDEdFRfkkSRQTE3PAl70zAHAxOYRSUlJeq62tPeGjsBDGGJ85c+Ylo9HI6Nw9E50+fZqsq6trJUlSzHRvIoqiDElJSa9N3Pfpp59uq6ioYHWIlkaj0T3zzDMrli1b9i5ivjcRvX79+hKGywQAAK7yVY9M6PkJAAAA2MHJBBFN0/SKFSv+xHY9fD7f9Pjjj7NeDwDj5HL5LFeSQxKJ5OyaNWsoH4WFELr3uvN0Ymp36PX6xJ07d15jozeRWCw+P/HfVqtVcOLECZLJOuyhKGq0q6trO0EQS8LCwvoQQz8+4uPj98Lk+QAAAAAAAABf4NQy9zYwQugui+XT6enpz7W0tOxisQ4AvieXy2edPHmybmBgYM1kxwkEgtsKhWKJP+bFwhjjpUuXVnZ1dW1DPlh6VSQSDRYWFqap1WpmhlFhjMPnzOmZOOm3WCzWGQyGeEbKd1FeXt76U6dOvWQwGGKRh9dRKBTeUCgUD1MUNcJweM5wedleLscGAh8sc+8etr5A+uI6ci12Lr+3wTL3jnE9PgAAcBsnexCNE4lEQywWT8fFxdWwWD4A35PL5bMaGxvPOEsOIYTotWvXlvlr0nSapumurq7tubm52Tweb5Tt+kwmk6yqqqp73bp1zzI15Cw0NHRo4r8NBkMsQRBxTJTtqgMHDhwxGAzxTz755PaxOYTc/RJJr127tswPySEAAPA3tv9yydm/jAIAAAD+xuUEER0fH/8+W2Wnp6fDjy/gE+M9h1yZ22fZsmXvNjY21rAVC8YYEwSRqFQqRRemzXWYkKmvrz9cUlKSGhcXtxex/GXaYrGIjh07tic2Nlbj9ZAzmqZjYmJsV0HEzc3NGrbnIrLnr3/963smk2lebm7uU+5MZL1gwYLD9fX1B9iMDQAAAAAAAAAm4nKCCL3d9jklFAqHmS5XIpF0wtAy4As5OTlP/fnPf/6HCz2HkEwmO5mdnV3GeBAYY4QxLigoWJuUlPT/7Nu378M9e/bcyAinz5aXl0sd9dypqqrq1Ol0JeXl5fN8kSjS6XTFBw8ePOZtT6Jf/OIXP5rY22AwxPb39yd4U6436uvrD+zYsePRpKSkN/l8vglNci0FAsHtDRs2wMqKAAAAAAAAAJ/i8hxE6MK0ufi3j8reOH36NJOTzMLcQ8AnCgoKMvbt23fMlWPDwsIuEwSxgslebRhj/MwzzyT39/dnfv755+vtTYw9Y8aMW8uXL69sa2t7lXbyZlBeXi7t7u4uunr16mq9Xj+ebGF87HxSUtKbp0+fftFZPJPAIpHomm17ly1b9m5XV9d27yP0TkVFBf/jjz8u+vTTT7famaOI3rhxYwmbvchcwOU5FbgcGwh8MAeRe9j8Asn1eWMcCca5dmAOIse4Hh8AALiN0wkihBAiCCJRo9GcZao8oVBo+MMf/jAPlrYHbMEY402bNm04fPhwndVqdTqsSSgU3pDL5SuYnHdILpfP6Onp2Xnu3LltrhwfFxe3Nz09XUFRlEvzDpEkGXrjxo0EvV6fYJMwGufVF56UlJRXXUlaOWA3QYQQokmSfJCiKMZ7JXqqsLBwzfnz5wt7e3vzEEJYJpOdHBwcTPNzWFz+wsvl2EDggwSRe9j+AsnG9eRqzFx+b4MEkWNcjw8AANzG+QQRQgj//Oc/P/+vf/1rMQNl0atWrXrho48+8uny4WDqkMvlMy5cuPB6Z2fnDleO5/F4d0pKStKqqqo6mYpBqVQ+2NjYeMhO0mZSQqHQkJqa+uLRo0drPO29I5fLY4eGhpKvXbu22s6wOre+BKWkpLyq1Wpf8SAMRwkilJSU9GZ7e/sLHpTJKrlcHqvT6bYmJSX9yV8TlE/A5S+8XI4NBD5IELmHq8mWyXA1Zi6/t0GCyDGuxwcAAG4LhAQRIghimUaj+cTbckQi0SBJkguh9xBgg1wun/Hhhx8eGxwcTHbxlLu5ubn5TE5GrFAo5u3fv7/VXnLEVTKZTLtt27YMpl4ncrk8YWhoKOGLL75I6uvrWz+225UvRJ4mdHFERESzvXmfhEKhQaFQLIQJ6ifF5S+8XI4NBD5IELmHq8mWyXA1Zi6/t0GCyDGuxwcAAG4LiAQRxhgnJye/rNVqX0JevJHGxcXt1el0JQyGBgBC6F5yqKurq1Kn0xW5eMrdjRs3EkzONSOXy2c0Nze3uttzyB4G5gGyq6Kigq/T6dZcu3ZtdVdX1/jwN4evaR6PN5qfn7+upqZG60Y1OC4urtrRc5GYmPhOR0fHc26UN9Vw+Qsvl2MDgQ8SRO7xxRdIJq8pl+Pl8nsbJIgc43p8AADgNk6vYjZu69atgqGhoceRd2+i9IIFC44yFRMA4wiCiN+/f/8/3EgO0enp6WVMJocwxrirq6uSieQQQgi1t7f/Pjk5+WUmyppIpVJZDhw4cKSrq2u7UqlcmJ6e/tzYql52Wa1WwaFDh+pIkhQwFYNOpyvyx5L3AAAAAAAAAMBlnE8QYYzvO3v2rMaNYTt2zZkzR3fgwIEjDIUFAEIIIblcPquxsfGQ2WwOd/UciUTSwfQqepmZmcVuJKhcotVqX8rJydnCZJkTqdXq/paWll35+flpkyWJzGaz+NSpU68zVa/FYgk9d+7cBqbKAwAAAAAAAIBgwOkEEcYYr1y58vXPPvssz8ui6PXr1xOMBAXAGLlcPqupqcmt+X54PN6djIwMBcNxLGxubq5ksswxuKmpSVNQULCWhbK/p9FodPn5+WlhYWF9jo759NNPtymVSpmLRdK//OUv2yd5HLe0tOwkSdLlpB4AAAAAAAAABDtOJ4gyMjKePX36NOltOWKx+HxVVdV5JmJiG3aBv2Oc6jDGOD09/Xd//vOf/zE8PBzrxql0amrqi0zeixhjfOrUqdetVisrQ6asVqvg4MGDhxQKRTQb5Y/TaDQ6giCWOEoSWa1WQWNjY52r5X3zzTeTJn/MZrP47Nmzpe7GCQAAwKeYmjeI+xNuAgAAABwQ4u8AHCkoKMg4duwYE70i6IULFx5koBy2fJ/wUSgUUcnJyZtHRkZ+NTIyIrV38OzZs/vXrVvXK5VK2yorK/sRfOnxqfEJ01taWtyen2fZsmXvdnV1MTq0bNOmTRvq6+vXOz/Sc1arVRAWFnZIKBQuoShqlK16KIoavXbt2osIoUZ7j+v1+gS5XB7rQoIN3759O9JZfV1dXdtIktxNUdSwJ/ECAAAAAAAAQDDh5CpmBEHE19bWnmGqVwSPxxvNysoiGhoaPmCiPG9hjLFKpQo/d+5c0ZUrVzI9nVhYIpF0JiYm/ukvf/nLEaZXmwI/NmE1PbeTQ/Hx8dU9PT2MDnNUKBTzNBpNt8ViCWWyXEd8sQogxhhHRUUd6uvrszdHkKvL3mOJRHLWlddVSkrKq1qt9hWPgg1eXF6VhcuxgcAHq5i5x1ffO5i4rlyPlcvvbbCKmWNcjw8AANzGuQSRQqGYV1tbe8adSX9dwePxRgsLC1doNBodk+W6CRMEEdvV1fU8A/MqfS8uLm7v+fPnCUgSsQdjfF9ycvJLniSHYmJi9l+8eDGf6YAkc+e6lARhCp/PN8nl8iVqtXqQzXqUSqWotra222Qy/WjOIYlE0qHX6x91UgQWiUTXXJkbKiwsrM9oNC70NNYgxeUvvFyODQQ+SBC5x5ffObxaxZaxKJwLxkQIJIgc43p8AADgNk7NQaRUKkX19fXHmE4OIXRvmEx9ff2x3Nxcn69ehDHGaWlpvw8PD+/RaDQ9TCaHEEJIp9MVS6XSVoIgEpksF9wjl8tnxMTE1HmSHJLJZCeffvppxidIz920af0kySGax+ON/vKXv2yTSCQdQqHQgO59ifHqi4zFYhHV1ta2sr1EvFqtNm3cuNFuQk2v1ycolcqoyc4nSTLc1YnDjUZjlFwud2ceKeBfmIENAACA6+B9FwAAphBOJYi++eabKLPZPIet8s1ms/jw4cN1BEHEsVWHrQvT5t4XGxtb3dra+oabExq7ZXBwMEWj0Zxhc1nyqQhjjC9cuODRSnpCofDG5s2bs1UqlYXJmC5Mm4vb29tfslOfYdmyZe+Wl5fPs1qtM7744osUvV7/qNlsfpAkyVlpaWkvIi+TRCaTSXbixAmvJ453prq6ujMiIuKEvcf6+/vXTHZuX1/fpI/bGhoaSnbneAAAAAAAAAAIRpxKEGk0mo78/Pw0iUTSgVjqEjzek4gkSTEb5U9EEER8eti33TqdrsiLYmiJRNKRkpLy6vgmFosdDZPDf/vb3yrdWA4cTGJsWNnLnZ2dOzw4nV63bp2CoqgRpuMqT43+nW2yMTIyslmhUCzs6ura/tZbbw3ZnkNR1Ehra+ubCoXiYW9fXx9//PHzbC8RT9M0HRcX976dh/Do6OjPHZ2HMcZffPGGcWMoAAAgAElEQVRFkhtV4VOnTr0ES94DAAAAAAAApjyapjm3URTF37RpU15ycvIrUqn0JE3Td93cnAoNDR3MzMwsZqsN+fn5GSEhIaOuxOIIn8//avPmzettyy4tLRXFxsbudXTe3Llzz5aWlorYattU2LZu3Tpj+fLl7zi6xs5EREQcYyOuzMzMEtu6li5dWklRFN+dcp544gkyNDT0mqfte+yxx95go30TN5VKJbD3Gpo/f36zo3MQQlgqlWrdbM7dDRs2FLHdngDamODvNgTStWIStNm/bfP3/Rjs93+wxshUnP6+H7h6j03l+ALh+WHKVGsvTXOrXb6OgwvPs79ff6xtfg+AyU2lUoU/8cQT5P3333+Ddi1RdDcjI+NZNDZZN1MbA8mhuxEREcdUKlW4ozq2b98ePVkBixYt2s9km6bSVlpa+uDcuXM7Jru+k4mIiDjmbsLGlc1ecsibus7f9wv82GOPvRESEnLHg2beLSsrkzLdxokbQgjbS9KNJY0dPXcyT157kyWdpuDGBH+3IRCuEZugzf5po7/vy2B/HQRrjEzF6e/7gav32FSOj8vtZstUay9Nc6N9/rqe/m63tzFwcuPcKmYTFRUVpXh67rfffiu4dOlSztjwrkknyIuKijoSExNT33Do0AHk5QUhCCK+trb2jNVq9WgiXx6PN/rkk09ub2xsrHFyKI6Kimrs7+9f7+Bxury8fJ694UbAscLCwtT6+vpDni4dL5FIzv72t79NY3reoaysrJKmpibNxH08Hm+0rKxsHkVRw96UrVQqZVqt9vXe3t485MZkkomJie90dHQ8503dzhAEEafRaHom7pPJZNrBwcFUe8dnZWUVNzU1VbtbD4/HG/3jH/84i+nnLUDBqiyOcfcD075AWh6cKf5c7SpY73tHfH1veHJ9AyFGhOB91xGuXxeux8e0QPo8gM8/17F5H/viGrrSbrbjCKTXsXP+zlA52vLz89e6lrSzb3wIzPbt26PHegc47VE0Z84cXUZGxrPbt2+PRjYrMLgSs0qlEnjT84SmaTohIWGnK3XRNI1nz57d56Sst10sCzaaRiUlJfHe9PwKDQ39x2S9vjzd7PUcomnme4llZ2dvmT59+m1X2xsSEnJn69atsUy312bD06dPN02sd6yHoN3jU1NTf+9q/Dbubtq0KY/ltgTKxgR/t4Gr18UfoM2+a6+/79Gp8JoIpviYjtXf9wNX77GpHB8X2+srU6mtE/nzPvYXrjxv/n59MraF+Dc95ZiXS93Ts2fPvoIQQpWVlX0IoYyCgoK1TU1NGrPZ7HBy6rGJf/cghFBzc3ObVCo9Nf5Yenr612Kx+PzE48PDwzspivq+x8G5c+d+N8nS405FRkY2EwTxoqvHf/vtt5P2Uvr000+3VVRUvAC9IpwrKCjIaGhoqPO055dAILi9devWdd725pkIY4xTU1N/39ra+rqdh+mFCxfWM1UXQgg1NDR8oFQqO8Vi8SGDwRCLnGTDrVarIDo6+iWE0EYm47C1aNGiAwihbeP/NpvN4evWrXu2ubn5PZqmJ/5FAN++fTvSw2rwwMDAaoTQAW9iBQAAAAAIQoHWm4ZGwdarg9v8eX8E2r3Jff7OUDnY8GSTMLvgbmlpaZRtuaWlpaKx+Uu46K47vTFUKpXYlTKLioqSXS1zqm6Oeui4is/nf8V0T5qtW7fOiImJ+WCSat26Xzy4JsVjPXWcuctGr6mJW0lJSaK9imNjY6ttJmN32qtuMpPNbTTFNib4uw1cvS7+AG32XXv9fY9OhddEMMXHdKz+vh+4eo9N5fi41lZfm2rtpemp1Vau8fdrlLGNsz2Irl+/7nFPHJFINGQymfpt96vVapNAIFgXERFxaGBgYK13ETIrMTFxV0dHx3nnR94zPDwc5cJheGhoKBkh1OZpXMEMY4wzMzOLbef2cQePx7tTUlKyrqqqyuXnbjIkSQquXr26obW19XWTySR1dJxQKBw2m82M1GlPU1PTXqVSeWTx4sWVzuYm6u7uLkIIUWzFUl1d3Xny5Ent4ODgD+Yk0+l0xUKhcM2XX35ZNn/+/CMURVmMRqMrrwu7RkZGpF4HC4JVIP91ytO/ok7FNgMAAPixQP08gM8/4EtBc+05myByNnxqMrNnz/5RcmgcRVGjCKHsuLi4SlcmsPYResWKFbvdOWFsCJBTV69eXY0QesWToIKZXC6f9cgjj7ze1NS0zfnRDt3dsGEDUVVV1clETARBPHr06FGNK0mOkJAQ1ocNqtVqE0LoqbS0tM/GhrnZe63gzs7OUsRigoimaXps6OVZ28fGhozuFwqFw93d3f9ve3u7+b///a+QrVgAAAAwAiPPfoS5+gXc0x94nsYFAAAABAVOrmJGkqRg586dtz2dDyYuLm6vTqcrcXbc2IpHGuTnJJFYLNYZDIZ4V469MG0uRgjhJ2b995KLvSVohNB9XgUYZDDG90ml0tbBwcFkL4qhV61a9cJHH33kdWIEY4wzMjKePXbsWKWr54hEokGTyTTP27pdVVBQsPbgwYOHrFarwM7DdE5OTn5DQ8MHLIaAxWJxt8FgiGOrAl9fUw6baquyuIJ7H5TumWp/QUXIP20OtvveGW+ulzeJGC4niLi4ilAg4/p14Xp8TAnkzwP4/HMu0NvLJYHwenaKk4mD4eHhBE+TQ2jCBNXONDU17U1LS3N5UmiW0IsXL6515cDc3Ny8zRH3Nz4VNfOAO0NpSJL0aMn2YCSXy2fNnz//mJfJIRQTE/MBU8mhlStXvuFOcsgf9u3bd3zz5s3ZPB5v1M7D+G9/+1tlRUWFx73+XEBv3Lgxn8XyAQAA+A5Xf5BwNS4AAADAJziZIPKWSCQacvXYkydPUklJSW+yGI5Tqamp7zk7BmOMBwYG0vv7+9dfunRpkzvl37x506XhaMGOIIhH6+vruwcGBtZ4U45EIjn79NNPE0zElJGR8ezp06dJJspi22RJIovFEvrxxx8XsVn/nj17+mUymZat8i0Wy0yCIOLQvex/UPwFAAAAOIyt3jaQ5AEAAAA8xMkEkavz69jD5/NHlixZcsTV42mapk+fPv3ismXL3vW0Tm+5sgy9SqXi9/X1rfdFPMFIqVQ+WF9ff2iyiZ9dIRKJruXn52e78pw5k5WVVeJpzyGLxfKzCckMn9m3b9/x1atXl9l5CH/66adb2aybpmk6MzOT4PP5JjbKHx0dnaXRaHr4fP7tqKioxpycnC0IkkUAADBVwHs9AACAKY+LCSL8v//9b6anJ4vF4vPu/ninaZo+d+6cIjEx8R1P62Xb8PBwgsVigaFiHiAIIn7//v2tZrM53JtyBALB7dzc3GyKooYZCAs3NTX9f56ePDo6+oBGo+kJCwu7VFRUlIIx9tkX2+bm5vfsvVYMBkOsXC5ntbeaWq0ezMzMZKT3liMWiyW0v79/fUNDw36E0F2xWNxdUFCw1pfXGAAAAAAAAAB8jYsJIq8IhUKPfrzTNE0//vjjL0ZERBxnOqbJqkWudYXGly5dymU7mGBUUFCQUVtbe8ab5c/H3N20aVM+U8vZI4TooqKiNKFQaPCmEKPRGF1TU3Ny0aJFdSRJihmKbVLjrxWxWKyzeQh3dHQ8z3b9f/nLX45ER0cfZruecQaDIW7fvn3NsbGxGqVSKfJVvQAAABxy9N0JhpcBAAAAXuDkMvcjIyO/8vBUeuHChfWe1ktR1ChCKDsiIuLQwMDAWk/LmRgPQgjxeDzL3LlzOxFCKDQ0dCg0NPQLhBCSSCSd06ZNs+zdu9dpQZ9//vlvPA3igQceGPL03EBWUFCQMbbylreTJ9Pp6ellLS0tJxgJbExNTY125syZD0dERNSNzYvkcQ+V3t7eLTweb71Op3vxT3+/tOvX311n9UsyRVGjRqORQAj1TNx/5cqVNRUVFXwmhuA5QtM0XVFR8VRSUtJL7e3tJPLRsACdTlfM5/PXf/XVV/n79u3zZSIZBD5v79FA/NE7FdsM3MeVZeWhhygA7PHm9cWF9wd3weeffZNdF1+1mQsxcB9N01zbcGho6CDtmbsqlSrc2xhUKpVg9uzZlz2M4ftYUlNTn/c2FpqmUUlJSaI3cWRmZhYjhDATsQTKtn379nnTp083eXHdvieVSlvZjnf16tW/mzZt2n+ZiPf++++/kZmZWUyz/JwjhPCCBQsO21R/d/PmzevZvl7jW3Z29pbp06ffZuK6uSokJOROfn7+WrbaxIGNCf5uA9euSSDW7486/V2/P+oM5I2p6+Xt+UzE5O97gAn+vh+4eI+xfV24Hh9X2hlodfujTn/WzwR/tzlYYuDEFlRDzKKjo48wMT8MRVGjBEGkSSSSDuRhNlEmk2lbW1v/5G0sCCF8/vz5Z7w5v6mpqdqXQ5D8TaFQzDt06NAhJuZsEolE1zZv3sz68upSqbRqxowZRibKMpvN4qampmrJ3LlnFApFNFtz59A0TSckJOy22Y0vXLhQyEZ99jQ0NHywY8eOh8eGhvok82+1WgUHDx48VFhY6NVqeAAAAAAAAADAJcGUIKKXLl36PlOFURRl0Ov1j6alpb2I3PzhyePx7mRnZzM2ke6lS5c2e1tGb2/vll27dl3KycnZEsyT7SoUinkajaZ7eHjY68mSRSLRNYIg0hialNohjDHu6enZ+e9///sXTJar1+sTKysrL0dFRR1SKpUyJsse9+c//7lNJpO1TdzX19e3vry8XMpGffZQFGUYGBjIWLdunYLH4436ok6r1Sro6el52hd1AQAAsMv2uxkMDwAAAAC8FEwJIiQQCBj/Id/a2vpmUVFRWlhYWJ+Lp9Br1qwpe+utt4aYqJ8giGVMrV5msVhEDQ0N+4N1sl0mew4JBILbBEGkMfU8TuaZZ55JPnfu3Da2yu/r69tQW1vbysZqZzRN04sXL6612Y27urpYXfLenmPHjr2rVCoXJiUlvcl2okggENz+zW9+U8ZmHQAAMEX4+49W/q4fAAAA4AzOJYiUSmWoyWSSenIugytM/UBNTY22vLw83pUfnjKZTPvXv/71PSbqxRhjrVb7OhNlTaTT6Yqrq6svBdPS3QUFBRlM9Rzi8Xh38vLysn2RHEIIoZkzZw6JRKJBNuswmUyy8dXOmO5NJJVK22z3ffbZZ3lM1uGqt956a6i9vf2FwsLCFW4kdd1Fr127toztnmUAAAAAAAAA4EucSxAhhDzq/SGRSDqZDmQilUplaW9vf6GsrGxeYmLiO2PLk/+gOzPTQ8ueeeaZ5GvXrqUxVd5EZrNZHCxLdxMEEX/w4EFGeg4hhOgNGzYQe/fubWOgLJeo1erBVatWlSEfdI/v7e3dsmfPnksFBQVMrNKHEEJo9+7dQ4sWLTowcZ/JZJLK5fIEpupwl0aj0REEsSQxMfEdPp9vYrLsyMjI442NjTVMlgkAAMAjtM1/AQAAAOAFLiaIPGI7DwpbKIoa7ujoeM5sNj+oVCoXpqSkvCqTybQymUz75JNPKpjsdTJt2rT/MFWWI4Hem0gul886evRoHQNL2SOEEEpJSXmtvr7+gPMjmVVfX3941apVLzCdzLBnfJLl3NzcDUw85zRN0z//+c97bXbj9vb2570t2xsURY12dHQ8J5fLH5LJZFrEwA8IHo93JzMzU8FAeAAAAAAAAADAKcGSIKJnz559xdeVqtXqfq1W+8rg4GDq4OBgKtO9Cm7duvUwk+U5Eqi9ieRy+aympqZWo9EYxUR5KSkpr2q12leYKMsTH330ESWXyx/yxYpcVqtVUF9f3yiVSluZWN0uJibmR0k1X09W7YharTYNDg6mFhcXp0ZHRx9Gnl9bRucXAwBMeTSHNn/z1x+oAu4PYwAAAACbgiVBxPoQM1/DGOPLly/n+rJOnU5XXFtb283m0uhMGU8OMTHnEEIIJSUlveHP5NA4tVptGhgYyMjLy9sYFxe3l+0eRYODgymVlZXdBEHEeVOOWq0eCg8Pt50DDJ85c6bUm3KZtHfv3ra+vr6Nubm52WPzE7n1o0gikXQwNb8YAAAAAAAAAHBN0CSI1Gp1v79jYJJKpeIPDQ097ut6TSaTrLKy8nJCQsJOriaJmE4OxcfHV7e3t7/IRFmTUSgU0WMTRGPk5K+WBw4cOKLT6UoIglgRERFxXCwW6xBLf+k1m83iurq6Vm+TRGKx+EeTxOt0uqKKigpGhv8xpb6+/rDRaFxYVFSUNnZdneLxeKMbN25kbH4xAAAAAAAAAOCaoEgQRUREnPB3DCyYnpqa+kJERMTxsZXTfNoFvKOj43dSqfRkUVFRii/rdYaN5FBPTw97P/wxxghjnJOTs/n999/vUavV12bOnDn0q1/9qu3JJ590urR9ZWVl38DAQIbBYIiXy+WP5uXlbVy8ePEHEomkAzE4PMBisYjq6upaFQpFtLdl2ZQb+vHHHxcxWSZTampqtM8880yqo0nnJ6CTk5NfC7YkNAAAAAAAAABMFOLvABhAL1q0qN7fQTCNoqgRhNCusQ0VFhauOXfu3FaLxRJqMBhiJ6zYxVovn8HBwWQej5eg1+tfW7p06S6KokbZqssVgZYcUiqVsp6VK7devHgxz9TQIB3f//XXX/8SIfRLkUgkuTBtbtWvv7vuUoKnqqpqfBjlEYQQqqio4Pf39yfcuHEj1mAwLDObzeHe3BsWi0UUFhZ2KCQkZIVarWZqaBs+f/58IUKIk0Ozxl5nzyGEnht/jQ0ODiZbLJbv5+KaM2eO7rnnntvlvygBAGBKwMi3fwzjZC9pAAAAwJ8CPkHE4/EsZWVlR/wdB9tqa2tPIIR+0FNKLpcndHV1bR0ZGZF+++23fL1eb7usuNdffsZWB3sjIiLiMYQQQVHUMPLDhJYYY7xgwQJNICSHMMY4Ozt7S0NDQ91kx5lMJll0dPShLJJUUBRlcLcelUplQQi1jW0/MPHeuHXrVpTZbA5HLtwPRqMxOiws7AxCaJ1arR50Ixz6wQcf7EIIFdk+oNfrE5RKZRTXe+CMv8ZIkhTHxcW9fuvWrajh4eFfl5SUEGPXGgAAAPdwYZJtAAA7IJELgI9hmubW56pSqZSp1eprrh6/ePHiD3p7e59iM6ZAMt6r5Ouvv5beunUrUq/XJ9gkj7x6o5VIJB2rV68u02g0471ZWL+BMMY4OTn5Za1W+zIT5bGZHJLL5TNOnjx5aGBgYI2r5/B4vNHNmzdn79u37zgbMSGEkFKpjOrq6tra0dGxA7lwD0RERBwfGBjIcKeOoqKilJqampP2HgvU1ylJkqFjvYymEiZe08H2hc7ba+Lt9fBH/dBm9uvk0hcwrlwvf/cg8td9D++79nH9unA9Pqb4+/PA1/zd3kD8LPJ3m4MlBk4I9B5EdFRU1FF/B8ElE3qV/IBSqYz697//HT40NJQ8PDy82GKxhLrTs2ScXq9PRAidDQsL6587d27nww8/XL+vru5ezyaWso1PPPHE7z766CNGkkMxMTH7L168yJnkEEL3lpzn8XiHEEKsJYnGeu88R5Lka2fPnn2+vb2dRJM87wMDA2vy8vLWHzhwgJHeeb29vXlKpTLg5vGZgskhAAAAAAAAwBQV6AkiNG/evGCcoJpxYz/M+5FN8qi4uDj5/Pnzhbdu3YqyGaI2adLIaDRGIYSiEEJF4X//+/no6OimeQTRMqFn0TivkkYEQTza1tb2ujdljJPJZCe3bdvG2rCyRx55ZKe7yaFxvkgSIfR9wuMFgiD+evToUY3RaHQ0KTXu7u7eijFuoplJ/OHe3t48hNArDJQFAAAgOPlqHqKg+CsvAAAAwLSAThBJJJIOvV4Pf+H3wt69e9vQhKRRcXFx8vXr1xOuXr26enBwMHls96RfpMbmBYpFCL2MEEIymawNIYTmzp3b+ZOf/OTfEomkc+bMmed37949ghBCriYcFArFvMbGxrqxeZC8MmfOnJ7i4uJstuaSyczMLG5qanK6KtlkfJUkQgghjUbTQZLkkoiIiEMDAwNr7R0zMDCwNjExcSe6N4mzUz/96U+HJ3tcq9W+VFhY2Dk21w8AAAAAAAAAAA4J5AQR/cQTT7zo7yCCzYSEEUWSZHh3d3dRZ2dnqTtD0SYklpIn7j969GgbQghlZWXVikSiIYQQCg8P76Qoajxp833iiCRJ8f79+1tNJpPU07aMG0sOpbE1XIggiPjm5uZKJsryZZJobFW6bLFYfMZgMMTZO0an0xVVVFS84EpiLSQkZNIEEUIIa7Xal5DNZOsAAAAAAAAAAPwvkBNE48kMwJKxFcuoioqKXenp6dvOnj37vLtzFk3kKHEUHh5+XiqVtkVFRR0NDw/vpyjqZltb2/NMJIciIyObi4uL89lKDsnl8oV1dXWtTPRyGjeeJHrggQcednMlMbdRFDVqNpvz+Xz+mYlLu4+zWCyhGzduzEMI1Tgr6+uvv3a6wpxer0+Qy+WxVVVV5z2LGAAAAAAAAAAAGwI2QZSYmLiro6PD32FMCSqVyqJSqXZVVFS8t3HjxrzTp08/P8ncNW6bMERtx/i+zk7bqYzcFx8fX33lyhVW5hxC6N68QwsWLHjdYrGEMl221WoViESiVoRQGttJosrKyj6LxbIOIXTWzsO4o6OjFLmQIDIYDE4TRAgh3N7e/hJCaKN7UQIAAJgi2J6HCOYfAgAAABy4z98BeAhWL/MDlUplaWxsrCEIYkl0dPRhxK0len+AzaXsx2VmZhb39/evZ6t8k8kkO3r0qIat8ieqrq7uHHtOf8RgMMQqlcqoyc7HGON//etfi12pq6+vb71cLnclmQQAAAAAAAAAwEcCMkEkEomGYHiZ/1AUNdrX17cxJycnn8/nm/wdj60FCxY0sp0cIklSzNS8Q5MZHBxMzsnJ2cJ2PTRN06tXryaEQqHdeYQuX77sNBH2zTffhLtY3XgvIgDcRTOwAQAAcB287wIAwBQSkAkiqVTa5u8YAEINDQ0f5Ofnp4WFhfUhjnwBEAqFNzZs2MBqcghjjFtbW19ict6hyapraWnZSZIk48PYbO3evXskNja2xl4MV69eXT3ZuSqVij80NJTsal1Xr15dU1FR4YvrBwAAXIU5tHENF2MCAAAAgl4gJohomUzW7u8gwD0ajUZnNBoXpqenl/F4vFF/xsLj8e7k5OSwNiH1uPz8/LXnzp1ztKQ9jRCiZ86cOcTn879GDCTOzGaz+NSpU6z3uKFpmo6Pj3/f3mMGgyF2soSO0WiMdSdhZrVa+d3d3awNzwMAAADsgMQTAAAAMImASxDxeDxLZGTkEX/HAX6opaXlnc2bN2f7K0nE4/HubNmyJZvtoYcXps297+9///vrdh6iw8LC+tLT05+rqKiY8fXXX8ssFktocXFxalxc3F7kZaLo008/3aZUKn+0yhjTdu/ePZSQkLDLdr/FYgm9dOlSsqPz/vvf/7rbwwmfPn36eXfjAwAAAAAAAADADs4liAQCwTCfz3fYA0Qqlbax3UMEeGbfvn3HCwsL0yQSSQfy4ZCzmTNnDpaUlKTV1taeYLMejDH+7aOy18dWXfvenDlzesrLy+cZjcaFLS0tu1QqlWX8sb1797bpdLoSgiBWyGQyrad1W61WwYcffsj6hNU0TdPz58//0N5jk8wxhP/5z38muVuXK5NfAwAAAAAAAADwDc4liCiKsggEAocJIJFIxOqS38A7Go2mQ6/XP5qWlvYi8kGSaMGCBY3PPvtsfFVVVSfbdZWUlCSePn2anLgvLi5u782bN5e89dZbQ5Odq9FoOoaGhtJSUlJeFQqFBk/qv3r16pqioqIUT851x766uhNhYWH97pxz8eLFPA+qwjqdrtCD8wAAAAQ/GA4GAAAA+BjnEkRO0KmpqS/6OwjgXGtr65tZWVkEYjFJNGfOnJ6SkhLW5xxCCCGCIOLr6uqOTdwnFApvpKWlveZqGTRN01qt9pWSkpKHPRl2ZrVaBceOHaskSVLgznmeiImJOWizC5tMJqm9Y5VKpdTRY86MjIx4dB4AAADgJkg4AQAAAE5wMkEUGho65OgxGF4WOJqamvYSBLFibJUzRgmFwhvFxcVpE4dzsWUsOdRqsVgmzrNDr127tsxZzyF71Gq1aWzY2RKxWKxz51yj0Rh96tQpe3MgMYem6eXLl1fxeLwfXNuLFy/m2psH6euvv5Z6WpVer0/w9FwAAAAAAAAAAMzhZIJIKpWesrdfLBaf93UswDsajaaDIIglERERx5kqUyAQ3FYoFA/7sOeQbXII8fn8kSVLlng1WbpGo9Hl5uamudubSKfTFXlTrysqKiqGH3rooR/M6WQ0GqPr6+tbbZNEnvYeGj9XLpfHOj8SAAAAAAAAAACbOJkgcsTdeVEAN1AUNdpwbXTd2LLvXrn//vuHlUplPNvJIYwxzs3N3WgvOYQQQpGRkSeY6L003ptIoVA8PDa/ltNEkcViCX3yySe3eVv3ZGiaphcvXlxru99gMMRVV1dfKigoWIvudde/7+bNm4u9qevatWtrvDkfAABA0GJqWBgMLwMAAABcEFAJogceeOCKv2MAnhMIBCZvzufxeHc2bdq0haKofzIVkz0kSQpWrlz5Rn19/SF7ySGEEB0bG/uj5Ik3Kisr+0wm0zyCIFa4MBE7/vjjj1lfIv4vf/nLEZlM1ma732w2i/ft29eMELq7aNGiOoPBEO9FNfjbb7/le3E+AAAAAAAITrSXGwDATQGVIAJTGp2amvri3r1729iqAGOMs7KyijUaTY/tamW2pk2bxsrcRxqNpkMul69YvHjxB2iSDzaTyST1RS+iJUuWvD/ZMZ999lmeJ0vcAwAAAAAAAADgFkgQgYCwYMGCwy0tLbvYKl+hUMxbsGBBY1NTU7XRaIxiqx5XUBRl6O3tfSo9Pb2Mx+ONOjgMd3Z2lrIdyy9+8YsTk8QAAAAAAAAAACBIcDFBRD/wwAOf+zsINmAn/B0fV4lEomsbNmwg2Cq/oOMhyjQAAB9ASURBVKAg4/3337/U39+/3tVzHnjggSG24hnX0tLyTlZWFoEc9CQyGo1Rcrmc1VXA1Gq1KSMjQ8FmHcPDww+TJClA9+aIgNcBAACAibz9XIDPFQAAAMBFIf4OwJ77779/2N8xMAgXFRUl37lzJzQ5OfnXQ0NDj9seML5qW3p6+tdRUVFH1Gr1EIJxswihe/MOlZSU5LMxKTVJkoJz587taG9vf8lqtbo1D44ny9t7oqGh4YPc3FxLfX19o52HcVdX11aEUCebMTQdPVojkUj+L71en8hG+X19fTkIoZywsLD+qKioI5GRkUc1Gk0ngtcAAAAAAAAAAPgMpmnu/QZTKBTRlZWVl233i8VinZcT4voSJggisbGxsc7dZcCFQqEhKyuLqKurO0Fz8QnywIVpc3Hyz/5zzc1rQaenpz/HxtAykiTFGo3mpCfDyXg83qjVap3BdEyOYIxxcnLyy1qt9mV7sZSVlc2jKIrVpKpSqRRVV1dfMpvNYjbrGScUCocfffTRP8XFxb1HURQMcfMtJt5z2PqLvb9i87Zeb6+HP+qHNvumzkDmy+vlTV2+qsfdupis15u6nfFnbFy+LghxPz6m+PO9cSp+Fvi6fi7cxxADh3BxiBmqrKzsFwqFP/rBazAYYsvLy6V+CMllY8ujb5BIJGc1Gs0Zd5NDCP2fVaKioqIOKZVKUbAMP3OnZ9isWbOuLlu27F225h26fv16rKdzDYnF4k8uTJvrs+eEpmm6ra3t1ejo6MO2j1mtVsEnn3zC6mTVCN0bapabm7uOz+d7tRKdq8xmc3hLS8vblZWV/yAIIs4XdQIAAAAAAADAVMbJBBFCCIWEhNhbJQp3d3cX+ToWV2GM70tOTn65vr6+Ua/Xez03TF9f34Y9e/bcWLp0aWWgJ4l+/d11OjIy8qirxz/wwAMDXV1drMx9gzHG//jHP1Z5ev7169cfK1ocVk0QRJyvnheapunVq1eX2UvQXLx4MdcXMWg0Gl1+fn6ar5JECN1LltbV1bUSBMHK8DYAAAABwdPP2oD+7gQAAAD4GmcTRI50dHSUKhSKaH/HYUsul8+SSqWt9oYBecNqtfK7urqeTUhI2OnLXitskEgkrs6VQ0dFRbmcTHIXTdP0+vXrX0hKSnoTedCd8O7du9N0Ol2RRqPpWb58+dtKpVLEQpg/olarB/Pz89fZ7jcajVG5ubl5vohhPEkkFAoNvqgPIYQsFouotra2NT09/Xe+qhMAAAAAAAAAphrOJojmzJlz3t5+i8Uiqq+vb0xPT/+dQqGI5kLPGowx7unpeX1wcDCZrTo6Ojp+95sH8RmSJMPZqoNt4eHh/Twez17PsB/g8XiWlStX1rAZi0qlsrS3t79QUFCw7qc//elNT8vp7OzcUV1dfSknJ2cL8sG9WF1d3ZmQkGA77A4PDQ0lsV33OI1Go1MoFPEpKSmv8ng8n8wPZLVaBS0tLTtXrVpF+qI+AAAAAAAAAJhquJogohcvXlzr6EGj0Rg1Nj/J5UceeWRPUVFRCvLjEtmpqankuXPnWJ8HRq/XJ546dep5tuthS0VFxfBDDz10wtlxjzzyyHsqlcppIokJdXV1JxYtWvSBN2WYzWZxQ0PDfsncuWcIgkhkM2lJ0zSdnJz8J9tEm06nK6qoqHBrJTZvUBQ1rNVqX9m8eXO2D4ec4ba2tpdIkgz1UX0AAAAAAFxDe7kBAIBDXE0QoXnz5p1ITEx8JywsrA9N8qZ27ty5bTU1NSf5fP7thISEt3NzczeQJCnwVc8ipVL5YHt7+0u+qAshhDo6OnaMJcQCDk3TdExMTL2zwx5//PE/+SQghFBJSUliZ2fnDibK0uv1iRqN5mxMTMx+Nnu3VVRUDMfGxtZM3Ge1WgXHjh3z2X04bt++fcflcvmSsQm0Wf/S8cgjj7xLUdQI2/UAAADgHHc/U/3ewxwAAAAINJxc5t4ekiTDdTpd3pUrVzInDOWy++HP4/EsS5YseS85OflPFRUVwywuFY/j4uKqdTpdEUvl2yUUCg0KhWIJRVE+mweGKSRJCnbu3HnbarXa7e0iFot1BoMh3lexaDSaHk9XM3Pmscceo1asWPEaG8u0KxSK6MrKyssT98lkMu3g4GAq03W5iiCIxLq6umMWi4WVOZmEQuGNP/zhDw/5qnfZFMblZT5hmXvf1Q9t9k2dgYzrz1Eg3QPwvsu9ul0xVT6TYJl79uv0Z/1ceJ1BDBwSMAmiiUiSDL127dqaoaGhJL1en2AwGGKRgydEJpO1RUZGHp0/f/6JPXv29DOcLMJ8Pv+2xWLx+ZCX6Ojow319fRt9Xa+3MMZ4/vz5zQMDA2vsPZ6YmPhOR0fHc76IY+XKlW+cPn2a1TltZDKZdvPmzflMJyoxxnjBggWN/f396yfspuVyeXxVVZXd+bt8QalUij788ENNX1/fesTsmySdl5e38cCBA0cYLBPYF3gfCu6BL4vcrdPf9fu7zYGG689RIN0D8L5rX7BfF4QC4z6FBBH7dfqzfi4kRiAGDgnIBJGt4uLi5PPnzxdev349Yaw3iN0nJyoq6khMTEz9/Pnzj1AUZUHMvADvOjmGFovF5/l8/ghCCH377bd8vV6f4ChGN/g9GeCpnJycLQ0NDfvtPESTJPkgRVHDvogjKyuruLm5eY+j3kxM4fP5I4mJierly5dXMNmbKC0t7fetra1vTNznqwSbM0qlMqq9vf35sd51Xr9ZLliwoPHzzz/P9j4y4ILA/1CYnD++LPobtNk1/v5REGi4/sMtkO6BQH+9OQPXxbFAuE8D+XmAzz/nuJAYgRi4hKbpoNrKysqkS5cu3RMaGnqNpum7tAP333//jczMzGKVSiVGY4kydzeVSiVwVH5ISMid+fPnNz/99NNrbM8rKSmJmzt37llH57oqKiqq0ZO4/b2VlJTE2WtPeHh4j69jSU1N/T09yX3CpNmzZ18uLS2VMRV7aWmpaPr06aaJdYSEhNyhKIrPVB3ebiqVShwbG1tNe3GNQ0JC7pSVlUn93ZYptAW7qXhNoM2+abO/X7uB9l7BZr3B2KZABtfFsUC4TwPZVLzv/NFef3+eBEsMnNj8HgCb24YNG4qcJYpomqalUqk2IyPj2dLSUpE7yaJNmzZtsFdeSEjIf+wlhiZuKpVKMH/+/ObJ4nLBXZVKFe5qvBzacGho6KBtYxISEt72RzyrV6/eMX369NsuX3UvhIaGXtu+fXs0E3Gfv+8XePbs2X02Vdwduy/9/Rz/YNu6dWvCokWL9tPuJ4ruPvHEE6S/459iW7CbitcE2uybNvv7tRto7xVs1huMbQpkcF0cC4T7NJBNxfvOH+319+dJsMTAiY2zq5gxobGxscZkMs3Ly8vbGB0dfZjH49kd3jM4OJh87NixPVVVVdeWL1/+NkEQceheF7FJu4l99dVX9iY3pjds2EDU1tZOupw7RVGj2dnZhO1y5e66ceNGrDfn+0tMTMwBm130r371q3Z/xNLS0rJLLpc/FBERcZztukwmk+z999/vzsrKKmZilbOoqCjbOXnw8ePHK7m2FHxVVVVnb2/vU08++eR2kUg0iFzsxjlnzhzdE088sYvl8AAAAAQO7MIGAAAAAA8EdYJo3IEDB4709fVt/OMf/zgrKSnpzbFE0Y9+oFosltDOzs4dGo2mRyQSXUtISHi7oKBgLUmSAtsf8xhjfPv27UjbMpYtW/ZefX29bfLDroqKiuGEhARvfvzigYGB1V6c7y/0rFmzrkzcwePxLHFxcZMm1dikVqtNDddGf/Pggw9+wnZdVqtV0NTUVJ2cnPyyN0miX393nY6MjDxqu99sNoebTCZWVmbz1l//+tf3TCbTvJycnHxHr8MJ6PXr1ytg1TIAAAAAAAAAYF9QTFLtLpIkw69du5bc39+f2dvbm4ec/LWJx+NZYmJiDkRERBydN2/eCYqiLAUFBWsPHjx4yGaCY1qpVC5Uq9X9bsQioCjqjqdtkUgkHXq9/lFPz/cXgiASNRrN2fF/+3uJdowxXr58+dudnZ07fFlvSkrKq21tba/Snr8Q7U6UHhERcXxgYCDDu+jYVVFRwf/444+Lbt26FanT6YrGVgP8/rW4bNmyPV1dXQo/hjhVBfuHAkxY6Rpos2/qDGTBeL1gkmp2wHVxLBDeqwL5eYDPP+e4MDkzxMAhUzJBNFFxcXFyZ2dn6diy3Ah58cTGxMTsv3jxYr6bp7myEppDixcv/qC3t/cpT8/3o4ntpletWvXCRx99RPkrmKysrJKmpiaNP+r2Mknk6P4JqGXhKyoq+N3d3eu1Wu1LRqMxSigUGhQKxcMURY34O7YpKNg/FODLomugzb6pM5AF4/WCBBE74Lo4FgjvVYH8PMDnn3NcSIxADBwS4u8A/G3v3r1tCKG2iooK/ieffJLX0dFRajAYYpGbT7BIJLoml8t93tth2rRpATv8JiwsrN9oNEYhhNDcuXM7/RUHQRCPMpEcmjZt2rffffed268prVb7ckpKCsIYe9OTyBb+5JNPShFCAZEgGhtGdgAhdCA3NzcvJydnGJJDAAAAAAAAAOA7U2IOIleoVCpLY2NjjcFgiJfL5Y8uW7bsXeRiJlEkEl0jCCINftC65/777x/2dwwkSQqOHTtWyURZ3333XcjMmTP1KSkpryYmJr7jzmTMWq325eTk5Jc9qTc8PPy8vf2Dg4PJJEmGe1KmP9XX1x8YS9wC/wiKv344EMxtAwAErmB+b/KmbcF8XRAKnPYFSpy2AjVuAPwKEkR2VFVVdXZ1dW0vLy+ft2zZsncn/NC3/bFPSySSs3K5fMVbb7015EldXv6ApxcsWPCjSYoD0c9+9jOfJ4swxviTTz5RDQ8PM7ISnFAovJGXl5ep1Wpf6ejoeM5kMs0jSfLBxMTEd/h8vsnZ+Vqt9qWxFfTcIhAIHCYmdTpdnrvlAQB+JJC/ZHoa+1RsMwAAABDInyGBHDvgCEgQTeKtt94a6urq2m4ymeaVl5fP27hxY8myZcve5fF4oyKRaDA9Pf253/72t2kURXmc3Lh+/bpXyYnJkgOBxJ2JvZmSn5+/9uOPP1Z5Ww6PxxtNSkp68w9/+MNDVVVVP+jNQ1HUcEdHx3M7duyYl5iY+I5QKDRMUhT+8MMPK0mSFHgb03h5Z8+efZ7B8sDUEYxfMIKxTQCA4BGM71FMtCkYrwtCgdcuiBeAKWLKT1LtCZIkQ5kYToYxxgsWLGjs7+9f7/zoH+PxeKN//OMfZwXoMuBYJpOdHBwcTEb3emb5NFmpVCpFe/bsuWGzCp3beDzenS1btmTX1taecLFeWW1tbavJZJI5OsbNicdxRERE88DAwBpHByxbtuzdrq6u7S6WB8C4YPtwYOLLYqBdE2ize4Jx0mU2BeP18nebAu315gxTz3GwXReEAvO9KpCeB/j8cx0XJmeGGDgEehB5gKm5hrKzs7d4mhxCCKHExMRdAZoc8iuMMe7t7VV6kxwa7zVUVlb2kKvJIYQQUqvVg4WFhWljwxbt6u3tzcvNzd3gaplz5879ZLLHu7q6tsnlckaG0YEpBaPg+KBjsh2BdD2gzQAEHnjf9U15/hTIbQmE2OEzHwAvQYLITwoKCjK8WTlLJBINrlu37jUmY5oqVCpVuDdDy4RC4Y2SkpJH29vbX/BkeKFarR586qmn1vF4vFEHh+Djx49XVlRUuJTAGh0dnenkENzR0fG8e1EC8L1A+EJoD1txc/16sBHfVGwzAP4UqPc023EH6nVBKLBjt8XFtsBnPgAMgQSRHxQUFKw9ePBgg9Vqne5pGbGxsbVOeg9hBG8adn322WfrPew9REskkrMKhWKJ7VxD7qqsrOzLysoiHD1uNpvDdTqdw2FjE928edNp76ArV66scTXhBIADOMA2tvm7ff5ot7/bxnabuRJHoAjG68W1Nvn7teXv9jvi73b6+9pwJRZ/X1Nf3nv+bh+b7eZCHBADh0CCyA9++tOfmgoKCjJWrVr1QkpKyqsymUwrkUg60P9ZKc3eimnfE4vFPcuXL9/l6HG5XD5LKBTeQAjdFQqFX2ZlZRUjjDl30966dSvK13VijPG//vWvxe6eJxQKbxQWFmbo9foV3kxKPtGhQ4cOJCQkOHwev/rqK5eujyvX0WKxhJ48eXKbO/EBAAAAAAAAAJg6YJJqjiFJMvTmzZux//nPf8KNRmPUyMjIL0dGRqS3bt2KMpvN4Tweb3T79u1LHK36hTHGsbGx1TqdrmjifolE0pGWlvZiTU2N1icNcQ4jhO6O/T9NkuSDTCVeJuPB5NR0dHT04aysLAUb8ZEkKd61a9dli8USavtYWFhYX3l5ebwLPcXuTvL49/h8vslisczyNFYAAAAAAAAAAMErxN8BgB8amwC7zdHjSqVS+tZbbw05ejw/P3/tvn37imz36/X6RB6Pd8xoNJY1Nze/R3MsMzg0NJSAEDrCdj0GgyHZ1eQQj8e7k52dnd/X18daXBRFGXQ63WsIobdtHzMajVGFhYXJCCGHk2ATBBGr0bg2lZXFYgldtWoV+dFHH1GexgsAAAAAAAAAIDjBELMAM1lySC6Xz5ps4mur1So4duzYnuTk5Jexn4ecKZXKiT1m8D//+c8ktuscW72s0IVD6bCwsMslJSVpBw4cYD1pFRcX955QKLTXOwkPDQ1Nel2uX7+e7EZV+NNPP93qVnAAAAAAAAAAAKYESBAFCYwx7urq2mk2m8OdHavVal+OjY3VkCQp9kVs9nz55Zc/mIB5aGgome06S0pKEvv7+9c7Oexuenr6c0aj8eGqqqpOtmNCCKGKigrLI488UmXvsZGREanDEzHGV65cyXSnLpPJJIUl7wEAAAAAAAAA2IIEUZDIz89fazvv0GR0Ol3xrl27LhEEEcdiWHZhjPFXX321YOK+W7duRbG6yhbGuL6+/tAkR9BJSUlvkiT5i5aWFocTR7OBpml6+fLlVTwe70dzDen1+oTJzp00gWQfvnLlirMkGQAAAAAAAACAKQYSREHA2dAyRywWi6iurq61oKBgra+HnI2MjPxq4r+tViv/5MmTz7JVX0529hYHvatosVjcI5fLH21vb3/BFxNl21NRUTEcExNzwHb/N998E06SpN1eYaRKxf/mm2+c9hizdfXq1dWexAgAAAAAAAAAIHhBgijAuTO0zB6LxSLat29fsy/nJVKpVPyrV6+usdmNT548+TobvYgKCgoy7CXQeDze6KpVq14wGAxLfDWczBGapun4+PjdtvutViv/5s2bdpex7+vry3NjNbbv6fX6hPLycqkHYQIAAAAAAAAACFKQIApw7g4tc2TCvEQCBsKalNFojLWX0BrrRbSNqXowxjgnJ+epgwcPHrJJpNAymeykUqlcyKUVvTQazXmRSDRku//rr7+W2jkc//vf//6Vnf2uwN3d3UUengsAAAAAAAAAIAhBgiiAeTq0zBGdTles0Wh60tPTf8dmb6LvvvvOUa8X3NXVVcpELyKM8X3JyckvNzQ01E1MDoWFhfWlp6c/t23btnWTrQjnJ3RSUtJrNvtwR0dHqVKpFNkefOvWrQW2+1zlbHU0AAAAAAAAAABTCySIApS3Q8scMRqNUS0tLW/Pnz+/uaioKIXJshG6F3d/f7/DlbdMJpPs2LFjL3lTh1wunyWVSlu1Wu3L4/t4PN5oSkrKqwRBPNrS0rJLpVL9aEJoLoiOjj7A5/NHJu4zGAxx9fX1rbZJIg8mqAYAAAAAAAAAAOyCBFGAys/PX8PE0DJHBgYG1tTV1TWnpaX9/sK0uYz1JlKpVPxLly7lTXaMTqcr8rQXkVKpfLCpqal1cHAweXwfj8cb3bJly0atVvsKRVEjk5zudxUVFZbY2Nga2/0GgyFu//79ZwiCSEQIYZIk+cPDwx4vVw/JJQAAAAAAAAAAE0GCKABhjPEnn3zyfyOEaDbrsVqt/NbW1jd+8yA+Q5KkmIkyR0dHw531ejKbzeHuzkWEMcZZWVklVVVVl2wTJytXrvxTbW3tCU/i9TWapumHH3641t5jRqMxWqPRnA0LC7us0+m2eTJB9TiTyST1OEgAAAAAAAAAAEEHEkQBiKZpemBgIEMulz+amJj4Dp/PN6F7ySJWEkZ6vT6xsrKymyCIOG/nJvryyy8TXDgMd3V1lbpa5vh8Q01NTRqLxRJq8zAdGRl5xL0o/au6uvp8QkLCLkePjw8D9GVMAAAAAAAAAACCG6ZpVjuhAB8gSTL05s2bsdevX0+4evXq6gnDqxifaFomk2lTU1Nf1Gg0HR6cjhMSEt7u7Ozc4cKxdHl5+bzJJpLGGOOtW7cKLly48LqjMsPCwvqMRuNCD2L1K/L/b+/+Q9rO7ziOf7K7gEEE80fAjJNhIa224DX9EZRrs/NE2xOckrRdhiJ1387cGZgdhfplLd0PuC0OypZBejpIq2CHLdRbW9Si9LQtd6HBcm2hF9FiMsz8HqRc/pBiQI7sj7OHeFVjm3yTxucD8t/3+3m/iZI/Xrw/n48sG8+fPz/7OlNCG0gIAmIAAAAAwDICohwky3LR/Pz87qmpqV8oirJ7bm5u5dTOa4dGWq12sba29tTw8HB3YnP/QJri4uIvV/WzlkR9fX37zZs3u3+0iEaj6ezsLJqYmDj95MkTx3pb1qqqqv40Pj7+x030mBU0Go1m//793kAg8HE61s/Pz48ePXr0l/n5+d94vd4pkebtigAAAACA7PZ2phtA6rnd7m+EELeWP0IIIZxO5+5oNLo7EolYgsFg44pQZdOB0dLSkk4IccFkMtVLknTm4sWLD5MJilwuV2mS4ZAQQmgikYhFCNEtxPeBiRBCtLe3l+zYseO81+utSOIGt0R5eflAkvWySiKRSMiyfMpoNFYoimJO9frPnz83CCE+F0IIvV4ftlgs/zSbzd1dXV3xTYZ+AAAAAIAcwATRFiXLcuH8/HzF3NxcRSQSsTx79qx0xcHFmwqNTCbTSG1t7akLFy5MrRcuHDp06HebOTunrKzss2AwaJckqWJ2dvZQOBz++crbyTZSUFCgnD17dlu2XmmfDJfLVebz+b6Ix+P6jZ9+fWazuddqtf7Z4/GE1KgHAAAAAMgOBET4gSzLhdPT041Pnz6tXVhYKFoVxqwbGmm12viBAwe6ysvLPR6PJ/aSRzSlpaWDU1NTjcn2o9VqFwsLC/8bjUZLk31npTd1e9lqzc3NH/b39w+JNJwp9TJ5eXmx6urqM3+59aj73e8i/EAAAAAAwBZAQIR1vdiadu/evdPLQc26IcWL7Uqjo6P/WDVNpNHr9bMqXq+ecDqde3p6eh6qVC+tGhoaWq9fv+4TKoVEQghRXFzsb2pqsrvdbkWtmgAAAACAzCAgQtKcTmfF9PT04XA4bF2eLlozrDCZTCN2u11aPg9JOJ1OXV9f3/9ecg19WhiNxq8URdmjRi21SJJUefny5SG1tpsJ8f00kcPhsPf29o6rVRMAAAAAoD4CIrwSSZIqb9y44UtmqigDEjU1Nb8fGxtzZ7qRVHO5XGXDw8PeUChUpVZNvV4famlp2bvG1kEAAAAAQA74SaYbwJvJ5/P5o9Hozo6Ojp1ms/mSyLJr0rdt23Zr46fePF6vNxgOh6utVutfhUrfeSwWK/H7/Z+oUQsAAAAAkBlMECEljh8/XjUwMHBNze1Pa8nF7WUvI0lS5eDg4OVYLFaS5lI5dZ4TAAAAAODH3s50A8gNvb2940VFRTsrKytPT05OfrS0tKTLUCuJffv2/StDtVXl8/n8BoNhT1VV1cnJycm2hYUFYzrqVFZW/t3v9xMOAQAAAEAOY4IIKedyucquXr16LRqNlqlde6tMD6326K13NL/Z+1NvIBD4SKTwTCi9Xj8ry/Kuzs7OeKrWBAAAAABkH84gQsp5vd6gJEl7TSbTiMqlEwcPHvybyjWzwrvfRRKBQKD9xZlQWq12MQXLJurr612EQwAAAACQ+5ggQtrIsqzr6+v7QlEUsxr1iouLv5ybm3tPjVrZrrW19f2JiYlzoVDoffGKE0Xl5eX/fvz4cVNqOwMAAAAAZCMmiJA2brd78dixY3aDwRBMdy2dTvdtXV2dK9113hSXLl2aCIVCHzQ0NEh5eXkxsckbzwoKCubr6upOpak9AAAAAECWYYIIadfV1ZU3NDR07u7du7JI4fk4KyRsNtuvBwcHe9Owdk5wOByNd+7cOacoym6x8d+A7xMAAAAAthgCIqimubn5wytXrlxL9Q1nFovl00Ag0J7KNXOVw+FofPDgQdvMzMxhsUZQVFJS8nkoFKpWuTUAAAAAQAaxxQyq6e/vH2lpaakuKChQUrWmXq+ftVqtW/Jg6lcxMDDwn5mZmbrW1tYPLBbLp8uHWf+QEmu12kW73S5lsEUAAAAAQAYwQQTVdXR06EdHR33BYLBRvMaWM51O921bW9t7Ho9nKoXtbTk2m+34+Pj4uVgs9rOampozY2Nj7kz3BAAAAABQFwERMubIkSO/un379iexWKxks+8aDIavbTZbU09Pz8N09LYVtbS0HN61a9cE19oDAAAAwNZDQISMevTWO5qTVtMf/H7/b+PxuD6Zd7Zv3z4sSZKdIAMAAAAAgNQgIEJWkGW58P79+yc3CooIhwAAAAAASD0CImSVFUFRRzweLxRCCKPR+JWiKGaTyTRy4sQJG+EQAAAAAACp9X8YpwJQl3SPIgAAAABJRU5ErkJggg==";

// define the function interface
extern const struct NETWORK_INTERFACE NETWORK = {
    .connect                  = &network_connect,
    .provision                = &network_provision,
    .tasks                    = &network_tasks,
    .is_ready                 = &network_is_ready,
    .get_IPAddr               = &network_get_IPAddr,
    .reset_connection         = &network_reset_connection,
};

// network manager variables
char nmNetSSID[64];
char nmNetPassword[64];
NetworkState_t nmState = NETWORK_STATE_DISCONNECTED;
static unsigned long nmCurrentCheckTime, nmPrevCheckTime;
static const long nmCheckInterval = NM_CHECK_INTERVAL;
static unsigned long nmReconnectStartTime;


// network LED flashing support variables
static unsigned long nmLEDPatternCurrentTime, nmLEDPatternPrevTime;
static const long nmLEDPatternInterval = NM_LED_PATTERN_INTERVAL;
static int nmLEDOutputValue[5][10] = {       // provide 5 unique flashing patterns
  {1, 0, 0, 0, 0, 0, 0, 0, 0, 0},   // Pattern 0 - blink 1x/sec
  {1, 0, 1, 0, 0, 0, 0, 0, 0, 0},   // Pattern 1 - blink 2x/sec
  {0, 0, 0, 0, 0, 0, 0, 0, 0, 0},   // Pattern 2 - OFF
  {1, 1, 1, 1, 1, 1, 1, 1, 1, 1},   // Pattern 3 - ON
  {1, 0, 1, 0, 1, 0, 1, 0, 1, 0}    // Pattern 4 - constant blink 5x/sec
};
static int nmLEDPatternIndex;         // row pointer: selects flashing pattern
static int nmLEDValueIndex;           // column pointer: selects current LED value

/*** Private Function Prototypes **********************************************/
static int selectBestClassroomChannel(void);  // Select cleanest channel (1, 6, or 11) for the provisioning AP
static void handleRoot(void);                 // Serve the home page contents
static void handleSave(void);                 // Save the user-selected SSID & Passphrase
static bool handleCaptivePortal(void);        // Captive portal redirect hook
static bool loadSavedWiFi(void);              // Attempt to connect using saved credentials
static void startConfigurationAP(void);       // Start the configuration AP
static void checkResetButton(void);           // Monitor the USER SWITCH to trigger provisioning again

// network manager functions
static void nmStartConnection(void);

/*** Public Function Definitions **********************************************/

bool network_connect(void)
{
  // initialize STATUS LED and RESET BUTTON
  pinMode(RESET_BUTTON_PIN, INPUT_PULLUP);

  // Initialize NETWORK CONNECTION STATUS LED
  pinMode(NETWORK_STAT_LED_PIN, OUTPUT);     // set digital pin as output
  digitalWrite(NETWORK_STAT_LED_PIN, 0);     // initialize LED state

  LittleFS.begin();

  // attempt to connect to AP using stored credentials...
  if(loadSavedWiFi())
  {
    // WiFi connection successful - prepare network manager state
    File f = LittleFS.open(config_file, "r");  
    String ssid = f.readStringUntil('\n');
    String pass = f.readStringUntil('\n');
    f.close();
    ssid.trim();
    pass.trim();
    // Update Network Connection Instance State
    strcpy(nmNetSSID, ssid.c_str());
    strcpy(nmNetPassword, pass.c_str());
    nmState = NETWORK_STATE_CONNECTED;
    nmCurrentCheckTime = 0;
    nmPrevCheckTime = 0;
    nmReconnectStartTime = 0;
    nmLEDPatternIndex = 3;       // network LED ON constantly
    nmLEDValueIndex = 0;         // point to first LED output level
    nmLEDPatternPrevTime = 0;
    SERIAL_PORT.println();
    SERIAL_PORT.print("[Network Manager] STARTED for SSID: ");
    SERIAL_PORT.println(nmNetSSID);
    // Update the Status LED
    digitalWrite(NETWORK_STAT_LED_PIN, 1);

    return true;
  }
  else
  {
    // Unable to connect using stored credentials
    
    // Update the Status LED
    digitalWrite(NETWORK_STAT_LED_PIN, 0);
    
    return false;
  }
}

void network_provision(void)
{
  startConfigurationAP();
  nmLEDPatternIndex = 0; // blink network LED @ 1x/sec
  nmLEDValueIndex = 0;   // point to first LED level
  nmLEDPatternPrevTime = 0;
  while(1)
  {
    // blink network LED to indicate provisioning web server is running
    nmLEDPatternCurrentTime = millis();
    if((nmLEDPatternCurrentTime - nmLEDPatternPrevTime) >= nmLEDPatternInterval)
    {
      nmLEDPatternPrevTime = nmLEDPatternCurrentTime;
      if(nmLEDValueIndex > 9)
      {
        nmLEDValueIndex = 0;
      }
      if(0 == nmLEDOutputValue[nmLEDPatternIndex][nmLEDValueIndex++])
      {
        digitalWrite(NETWORK_STAT_LED_PIN, 0);
      }
      else
      {
        digitalWrite(NETWORK_STAT_LED_PIN, 1);
      }
    }
    // process events from provisioning web page
    // system reboots when new credentials are saved to the file
    if (WiFi.getMode() == WIFI_AP) {
    dnsServer.processNextRequest(); 
    server.handleClient();
    }
  }
}

// run the network manager tasks
// checks/maintains WiFi connection using current saved parameters
// checks for user button press/hold for 3 seconds to delete parameters and start AP provision
void network_tasks(void)
{
  // Check for button press to restart provisioning
  checkResetButton();

  // Update network LED state
  #if defined(ARDUINO_RASPBERRY_PI_PICO_W) || defined(ARDUINO_SPARKFUN_XRP_CONTROLLER)
  nmLEDPatternCurrentTime = millis();
  if((nmLEDPatternCurrentTime - nmLEDPatternPrevTime) >= nmLEDPatternInterval)
  {
    nmLEDPatternPrevTime = nmLEDPatternCurrentTime;
    switch (nmState)
    {
      case NETWORK_STATE_DISCONNECTED:
        nmLEDPatternIndex = 2;       // network LED OFF constantly
        break;
      case NETWORK_STATE_ATTEMPTING_CONNECTION:
        nmLEDPatternIndex = 4;       // network LED toggling constantly
        break;
      case NETWORK_STATE_CONNECTED:
        nmLEDPatternIndex = 3;       // network LED ON constantly
        break;
      default:
        break;
    }
    if(nmLEDValueIndex > 9)
    {
      nmLEDValueIndex = 0;
    }
    if(0 == nmLEDOutputValue[nmLEDPatternIndex][nmLEDValueIndex++])
    {
      digitalWrite(NETWORK_STAT_LED_PIN, 0);
    }
    else
    {
      digitalWrite(NETWORK_STAT_LED_PIN, 1);
    }
  }
  #endif

  // Evaluate status of network connection, attempt re-connect if necessary
  nmCurrentCheckTime = millis();
  if((nmCurrentCheckTime - nmPrevCheckTime) >= nmCheckInterval)
  {
    nmPrevCheckTime = nmCurrentCheckTime;
    uint8_t hardwareStatus = WiFi.status();
    switch (nmState)
    {
      case NETWORK_STATE_CONNECTED:
        if (hardwareStatus != WL_CONNECTED)
        {
          SERIAL_PORT.println();
          SERIAL_PORT.println("[Network Manager] CRITICAL: Link dropped!");
          WiFi.disconnect();
          nmStartConnection();
        }
        break;
      
      case NETWORK_STATE_ATTEMPTING_CONNECTION:
        if (hardwareStatus == WL_CONNECTED)
        {
          SERIAL_PORT.println();
          SERIAL_PORT.print("[Network Manager] Connected! IP Address: ");
          SERIAL_PORT.println(WiFi.localIP());
          nmState = NETWORK_STATE_CONNECTED;
        } 
        else if (nmCurrentCheckTime - nmReconnectStartTime >= NM_RECONNECT_TIMEOUT)
        {
          SERIAL_PORT.println();
          SERIAL_PORT.println("[Network Manager] Connection attempt timeout. Recycled attempt...");
          WiFi.disconnect();
          nmStartConnection();
        }
        break;

      case NETWORK_STATE_DISCONNECTED:
          nmStartConnection();
          break;

      default:
          break;
    }
  }

}

bool network_is_ready(void)
{
  if(nmState == NETWORK_STATE_CONNECTED)
  {
    return true;
  }
  else
  {
    return false;
  }
}

char* network_get_IPAddr(void)
{
  String ipString = WiFi.localIP().toString();
  strcpy(localIPAddress, ipString.c_str());
  return localIPAddress;
}

void network_reset_connection(void)
{
  if (LittleFS.exists(config_file)) {
    LittleFS.remove(config_file);
  }
  SERIAL_PORT.println();
  SERIAL_PORT.println("[Network Manager] Deleting saved WiFi Credentials...and Rebooting!");
  delay(1000);
  watchdog_reboot(0, 0, 0);
}

/*** Private Function Definitions *********************************************/

int selectBestClassroomChannel(void) {
  int scanResult = WiFi.scanNetworks();
  long rssi1 = -100, rssi6 = -100, rssi11 = -100;

  for (int i = 0; i < scanResult; i++) {
    int ch = WiFi.channel(i);
    long rssi = WiFi.RSSI(i);
    if (ch == 1 && rssi > rssi1) rssi1 = rssi;
    if (ch == 6 && rssi > rssi6) rssi6 = rssi;
    if (ch == 11 && rssi > rssi11) rssi11 = rssi;
  }

  // Pick the channel with the weakest "loudest neighbor"
  if (rssi1 <= rssi6 && rssi1 <= rssi11) return 1;
  if (rssi6 <= rssi1 && rssi6 <= rssi11) return 6;
  return 11;
}

void handleRoot(void) {
  // Adobe RGB (29, 49, 72) deep corporate blue background with Arial white typography
  String html = "<html><head><meta name='viewport' content='width=device-width, initial-scale=1.0'>";
  html += "<style>";
  html += "*{box-sizing:border-box;margin:0;padding:0;}";
  html += "body{font-family:'Arial',sans-serif;background:rgb(29,49,72);color:#ffffff;display:flex;justify-content:center;align-items:center;min-height:100vh;padding:20px;}";
  html += ".card{background:rgba(255,255,255,0.08);padding:30px;border-radius:12px;border:1px solid rgba(255,255,255,0.15);width:100%;max-width:400px;text-align:center;box-shadow:0 10px 25px rgba(0,0,0,0.3);}";
  html += ".logo{max-width:150px;height:auto;margin-bottom:25px;filter:brightness(0) invert(1);}"; // Forces logo vector/bitmap elements to pure white
  html += "h2{font-size:1.5rem;font-weight:600;margin-bottom:35px;color:#ffffff;letter-spacing:0.5px;}";
  html += ".field-group{text-align:left;margin-bottom:18px;}";
  html += "label{display:block;font-size:0.875rem;font-weight:bold;margin-bottom:8px;color:#ffffff;text-transform:uppercase;letter-spacing:1px;}";
  html += "select,input[type='password']{width:100%;padding:14px;border:2px solid rgba(255,255,255,0.3);border-radius:6px;font-size:1rem;font-family:'Arial',sans-serif;background:rgba(0,0,0,0.2);color:#ffffff;outline:none;-webkit-appearance:none;}";
  html += "select option{background:rgb(29,49,72);color:#ffffff;}"; // Ensures option dropdown lists stay readable across mobile browsers
  html += "select:focus,input[type='password']:focus{border-color:#ffffff;background:rgba(0,0,0,0.4);}";
  html += "input[type='submit']{width:100%;padding:14px;background:#ffffff;color:rgb(29,49,72);border:none;border-radius:6px;font-size:1rem;font-weight:bold;font-family:'Arial',sans-serif;cursor:pointer;transition:all 0.2s ease;margin-top:10px;text-transform:uppercase;}";
  html += "input[type='submit']:hover{background:rgba(255,255,255,0.9);transform:translateY(-1px);}";
  html += "input[type='submit']:active{transform:translateY(0);}";
  html += ".footer{margin-top:25px;font-size:0.75rem;color:rgba(255,255,255,0.5);letter-spacing:0.5px;}";
  html += "</style>";
  html += "<title>Wi-Fi Setup</title></head><body>";
  
  html += "<div class='card'>";
  html += "<img class='logo' src='data:image/png;base64," + logo_base64 + "' alt='Company Logo'>";
  html += "<h2>Connect Robot</h2>";
  //html += "<div style='height: 15px;'></div>"; // Inserts a clean 15-pixel invisible gap
  html += "<form action='/save' method='POST'>";
  
  html += "<div class='field-group'>";
  html += "<label>Select Network</label>";
  int n = WiFi.scanNetworks();
  if (n == 0) {
    html += "<select name='ssid' disabled><option>No networks found</option></select>";
  } else {
    html += "<select name='ssid'>";
    for (int i = 0; i < n; ++i) {
      String currentSSID = WiFi.SSID(i);
      currentSSID.trim(); // Strip hidden whitespace configurations
      
      // Sanitization: Blocks entirely blank lines, empty returns, or explicit hidden indicators
      if (currentSSID != "" && currentSSID.length() > 0 && !currentSSID.equals("[Hidden]")) {
        // Formatted option block with dBm calculations stripped out completely
        html += String("<option value='") + currentSSID + "'>" + currentSSID + "</option>";
      }
    }
    html += "</select>";
  }
  html += "</div>";
  
  html += "<div class='field-group'>";
  html += "<label>Wi-Fi Password</label>";
  //html += "<input type='password' name='pass' placeholder='••••••••'>";
  html += "<input type='password' name='pass'>";
  html += "</div>";
  
  html += "<input type='submit' value='Connect Robot'>";
  html += "</form>";
  html += "<div class='footer'>IoT Device Provisioning Portal</div>";
  html += "</div></body></html>";
  
  server.send(200, "text/html", html);
}

void handleSave(void) {
  if (server.hasArg("ssid") && server.hasArg("pass")) {
    String ssid = server.arg("ssid");
    String pass = server.arg("pass");
    
    // Log Case 1: Print new SSID name upon successful web form submission
    SERIAL_PORT.println("\n====================================");
    SERIAL_PORT.println("PROV_SUCCESS: Device successfully provisioned!");
    SERIAL_PORT.print("Target SSID Name: ");
    SERIAL_PORT.println(ssid);
    SERIAL_PORT.println("Saving to LittleFS and rebooting system...");
    SERIAL_PORT.println("====================================");

    File f = LittleFS.open(config_file, "w");
    if (f) {
      f.println(ssid);
      f.println(pass);
      f.close();
      
      // Matching submission layout style block
      String html = "<html><head><meta name='viewport' content='width=device-width, initial-scale=1.0'>";
      html += "<style>body{font-family:'Arial',sans-serif;background:rgb(29,49,72);color:#ffffff;display:flex;justify-content:center;align-items:center;min-height:100vh;margin:0;}";
      html += ".card{background:rgba(255,255,255,0.08);padding:30px;border-radius:12px;border:1px solid rgba(255,255,255,0.15);text-align:center;max-width:350px;box-shadow:0 10px 25px rgba(0,0,0,0.3);}</style></head>";
      html += "<body><div class='card'><h3 style='margin-bottom:10px;font-size:1.3rem;'>Credentials Saved!</h3><p style='color:rgba(255,255,255,0.7);font-size:0.95rem;'>Connecting to network... Device rebooting.</p></div></body></html>";
      
      server.send(200, "text/html", html);
      SERIAL_PORT.printf("Credentials Saved! Connecting...\r\n");
      delay(2000);
      watchdog_reboot(0, 0, 0); 
    } else {
      server.send(500, "text/plain", "File system error.");
      SERIAL_PORT.printf("File system error.\r\n");
    }
  }
}

bool handleCaptivePortal(void) {
  String hostHeader = server.hostHeader();
  if (hostHeader != "192.168.4.1" && hostHeader != "picow.local") {
    server.sendHeader("Location", "192.168.4", true);
    server.send(302, "text/plain", ""); 
    return true;
  }
  return false;
}

bool loadSavedWiFi(void) {
  if (!LittleFS.exists(config_file)) return false;
  File f = LittleFS.open(config_file, "r");
  if (!f) return false;
  
  String ssid = f.readStringUntil('\n');
  String pass = f.readStringUntil('\n');
  f.close();
  
  ssid.trim();
  pass.trim();

  SERIAL_PORT.println();
  SERIAL_PORT.print("Attempting connection to saved network: ");
  SERIAL_PORT.println(ssid);
  
  // Create a unique STA HOSTNAME using the last 2 macAddr bytes
  // "XRPBeta_abcd", "XRP_abcd", "CETAIoT_abcd"
  WiFi.macAddress(macAddress);     // read/save the mac address of the radio
  #if defined(ARDUINO_RASPBERRY_PI_PICO_W)
  sprintf(sta_hostname, "CETAIoT-%02x%02x", macAddress[4], macAddress[5]);
  #elif defined(ARDUINO_SPARKFUN_XRP_CONTROLLER)
  sprintf(sta_hostname, "XRP-%02x%02x", macAddress[4], macAddress[5]);
  #elif defined(ARDUINO_SPARKFUN_XRP_CONTROLLER_BETA)
  sprintf(sta_hostname, "XRPBeta-%02x%02x", macAddress[4], macAddress[5]);
  #else
   #error Unsupported board selection
  #endif

  WiFi.setHostname(sta_hostname);
  WiFi.mode(WIFI_STA);
  WiFi.begin(ssid.c_str(), pass.c_str());
  
  int attempts = 0;
  while (WiFi.status() != WL_CONNECTED && attempts < 20) {
    #if defined(ARDUINO_RASPBERRY_PI_PICO_W) || defined(ARDUINO_SPARKFUN_XRP_CONTROLLER)
      digitalWrite(NETWORK_STAT_LED_PIN, 1);
      delay(100);
      digitalWrite(NETWORK_STAT_LED_PIN, 0);
      delay(100);
      digitalWrite(NETWORK_STAT_LED_PIN, 1);
      delay(100);
      digitalWrite(NETWORK_STAT_LED_PIN, 0);
      delay(100);
      digitalWrite(NETWORK_STAT_LED_PIN, 1);
      delay(100);
      digitalWrite(NETWORK_STAT_LED_PIN, 0);
      delay(100);
    #else
      delay(600);
    #endif  
    attempts++;
  }
  if (WiFi.status() == WL_CONNECTED) {
    
    // Print current network metrics when loading successfully from memory
    SERIAL_PORT.println("\n====================================");
    SERIAL_PORT.print("STA_SUCCESS: Connected to saved network: ");
    SERIAL_PORT.println(WiFi.SSID()); // Pulls current active name string directly from router core
    SERIAL_PORT.print("Assigned IP Address: ");
    SERIAL_PORT.println(WiFi.localIP());
    SERIAL_PORT.print("STA Hostname: ");
    SERIAL_PORT.println(sta_hostname);
    SERIAL_PORT.println("====================================");
    return true;
  }
  else {
    
    SERIAL_PORT.println("\nConnection failed or timed out.");
    return false;
  }
}

void startConfigurationAP(void) {
  SERIAL_PORT.println("\nSwitching to Configuration AP Mode...");
  WiFi.mode(WIFI_AP);
  WiFi.softAPConfig(apIPAddr, apGateway, apSubnet);

  // Select the "quietest non-overlapping" WiFi channel to start the network (1, 6, or 11)
  ap_channel = selectBestClassroomChannel();
  
  // Create a unique AP SSID, and AP Passphrase using the last 2 macAddr bytes
  // "XRPBeta_abcd", "XRP_abcd", "CETAIoT_abcd"
  // Note: the WiFi passphrase is set to match the SSID
  WiFi.macAddress(macAddress);     // read/save the mac address of the radio
  #if defined(ARDUINO_RASPBERRY_PI_PICO_W)
  sprintf(ap_ssid, "CETAIoT_%02x%02x", macAddress[4], macAddress[5]);
  sprintf(ap_pass, "CETAIoT_%02x%02x", macAddress[4], macAddress[5]);
  #elif defined(ARDUINO_SPARKFUN_XRP_CONTROLLER)
  sprintf(ap_ssid, "XRP_%02x%02x", macAddress[4], macAddress[5]);
  sprintf(ap_pass, "XRP_%02x%02x", macAddress[4], macAddress[5]);
  #elif defined(ARDUINO_SPARKFUN_XRP_CONTROLLER_BETA)
  sprintf(ap_ssid, "XRPBeta_%02x%02x", macAddress[4], macAddress[5]);
  sprintf(ap_pass, "XRPBeta_%02x%02x", macAddress[4], macAddress[5]);
  #else
   #error Unsupported board selection
  #endif

  if(WiFi.beginAP(ap_ssid, ap_pass, ap_channel) == WL_CONNECTED)
  {
    SERIAL_PORT.print("Access Point SSID Started: ");
    SERIAL_PORT.println(ap_ssid);
    SERIAL_PORT.print("IP Addr: ");
    SERIAL_PORT.print(WiFi.softAPIP());
    SERIAL_PORT.print(" WiFi Channel: ");
    SERIAL_PORT.println(ap_channel);
    SERIAL_PORT.println("Connect your phone/computer to view the portal.");
  } 
  else 
  {
    SERIAL_PORT.println("AP failed to start!.");
  }
  
  // Start the background DNS intercept handler
  dnsServer.start(DNS_PORT, "*", IPAddress(192, 168, 4, 1));
  
  server.on("/", handleRoot);
  server.on("/save", HTTP_POST, handleSave);
  
  // Capture fallback requests from operating system network verification background utilities
  server.onNotFound([]() {
    if (!handleCaptivePortal()) {
      handleRoot();
    }
  });
  
  server.begin();
}

void checkResetButton(void) {
  static int lastButtonState = HIGH;
  static unsigned long buttonPressedTime = 0;
  static bool isResetting = false;

  int currentButtonState = digitalRead(RESET_BUTTON_PIN);

  if (currentButtonState != lastButtonState) {
    delay(DEBOUNCE_DELAY); 
    currentButtonState = digitalRead(RESET_BUTTON_PIN);
    if (currentButtonState == LOW) {
      buttonPressedTime = millis();
    }
  }

  if (currentButtonState == LOW && !isResetting) {
    if (millis() - buttonPressedTime >= HOLD_TIME) {
      isResetting = true;
      if (LittleFS.exists(config_file)) {
        LittleFS.remove(config_file);
      }
      SERIAL_PORT.printf("\r\nDeleting saved WiFi Credentials...and Rebooting!\r\n");
      delay(1000);
      watchdog_reboot(0, 0, 0);
    }
  }
  lastButtonState = currentButtonState;
}

void nmStartConnection(void)
{
  SERIAL_PORT.printf("\r\n[Network Manager] Triggering connection to SSID: %s ...\r\n", nmNetSSID);
  WiFi.begin(nmNetSSID, nmNetPassword);
  nmReconnectStartTime = millis();
  nmState = NETWORK_STATE_ATTEMPTING_CONNECTION;
}